## CMakeLists.txt
```
#
# Copyright (c) 2016-2026 Makerdiary <https://makerdiary.com>
#
# SPDX-License-Identifier: Apache-2.0
#

cmake_minimum_required(VERSION 3.20.0)
find_package(Zephyr REQUIRED HINTS $ENV{ZEPHYR_BASE})
project(shell)

target_sources(app PRIVATE src/main.c)
```

## sample.yaml
```
sample:
  name: Shell sample
tests:
  sample.shell:
    sysbuild: true
    build_only: true
    integration_platforms:
      - nrf9151_connectkit/nrf9151
      - nrf9151_connectkit/nrf9151/ns
```

## prj.conf
```kconfig
CONFIG_HEAP_MEM_POOL_SIZE=1024

CONFIG_PRINTK=y
CONFIG_SHELL=y
CONFIG_LOG=y
CONFIG_LOG_CMDS=y
CONFIG_INIT_STACKS=y
CONFIG_THREAD_STACK_INFO=y
CONFIG_KERNEL_SHELL=y
CONFIG_THREAD_MONITOR=y
CONFIG_BOOT_BANNER=n
CONFIG_THREAD_NAME=y
CONFIG_DEVICE_SHELL=y
CONFIG_POSIX_API=y
CONFIG_POSIX_TIMERS=y
CONFIG_DATE_SHELL=y
CONFIG_THREAD_RUNTIME_STATS=y
CONFIG_THREAD_RUNTIME_STATS_USE_TIMING_FUNCTIONS=y
CONFIG_STATS=y
CONFIG_STATS_SHELL=y

CONFIG_ADC=y
CONFIG_ADC_SHELL=y
CONFIG_GPIO_SHELL=y
CONFIG_INPUT=y
CONFIG_INPUT_SHELL=y
CONFIG_INPUT_EVENT_DUMP=y
```

## src/main.c
```c
/*
 * Copyright (c) 2015 Intel Corporation
 * Copyright (c) 2016-2026 Makerdiary <https://makerdiary.com>
 *
 * SPDX-License-Identifier: Apache-2.0
 */

#include <zephyr/kernel.h>
#include <zephyr/shell/shell.h>
#include <zephyr/version.h>

int main(void)
{
	return 0;
}

static int cmd_version(const struct shell *sh, size_t argc, char **argv)
{
	ARG_UNUSED(argc);
	ARG_UNUSED(argv);

	shell_print(sh, "Zephyr version %s", KERNEL_VERSION_STRING);

	return 0;
}


SHELL_CMD_ARG_REGISTER(version, NULL, "Show kernel version", cmd_version, 1, 0);
```
