## CMakeLists.txt
```
#
# Copyright (c) 2019 Nordic Semiconductor
# Copyright (c) 2016-2026 Makerdiary <https://makerdiary.com>
#
# SPDX-License-Identifier: LicenseRef-Nordic-5-Clause
#

cmake_minimum_required(VERSION 3.20.0)

find_package(Zephyr REQUIRED HINTS $ENV{ZEPHYR_BASE})
project(coap-client)

if(CONFIG_COAP_SAMPLE_DTLS)
  set(gen_dir "${ZEPHYR_BINARY_DIR}/include/generated")

  generate_inc_file_for_target(
    app
    ${CONFIG_COAP_SAMPLE_CA_CERT_FILE}
    "${gen_dir}/coap_sample_ca_cert.inc"
  )

  generate_inc_file_for_target(
    app
    ${CONFIG_COAP_SAMPLE_CLIENT_CERT_FILE}
    "${gen_dir}/coap_sample_client_cert.inc"
  )

  generate_inc_file_for_target(
    app
    ${CONFIG_COAP_SAMPLE_CLIENT_KEY_FILE}
    "${gen_dir}/coap_sample_client_key.inc"
  )
endif()

# NORDIC SDK APP START
target_sources(app PRIVATE src/main.c)
# NORDIC SDK APP END
```

## Kconfig
```
#
# Copyright (c) 2019 Nordic Semiconductor ASA
# Copyright (c) 2016-2026 Makerdiary <https://makerdiary.com>
#
# SPDX-License-Identifier: LicenseRef-Nordic-5-Clause
#

menu "CoAP client sample"

config COAP_SAMPLE_RESOURCE
	string "CoAP resource - defaults to Californium observable resource"
	default "obs"

config COAP_SAMPLE_SERVER_HOSTNAME
	string "CoAP server hostname"
	default "californium.eclipseprojects.io"

config COAP_SAMPLE_SERVER_PORT
	int "CoAP server port"
	default 5684 if COAP_SAMPLE_DTLS
	default 5683

config COAP_SAMPLE_REQUEST_INTERVAL_SECONDS
	int "Request interval in seconds"
	default 5

config SAMPLE_RECONNECT_DELAY_SECONDS
	int "Reconnect delay in seconds"
	default 30
	help
	  Delay before reconnecting to the server after a recoverable error,
	  such as a failed DTLS handshake or a failed request.

config COAP_SAMPLE_DTLS
	bool "Enable DTLS (CoAPS) with mutual X.509 authentication"
	select NET_SOCKETS_SOCKOPT_TLS
	select NET_SOCKETS_ENABLE_DTLS
	select TLS_CREDENTIALS
	help
	  Enable DTLS for CoAP (CoAPS) using mutual X.509 certificate
	  authentication.  When enabled, the default server port changes to
	  5684 and the socket is created with IPPROTO_DTLS_1_2.

if COAP_SAMPLE_DTLS

config COAP_SAMPLE_DTLS_SEC_TAG
	int "DTLS security tag"
	default 42
	help
	  Security tag used to store the DTLS credentials.

config COAP_SAMPLE_DTLS_HANDSHAKE_TIMEOUT_MAX_MS
	int "Maximum DTLS handshake retransmission timeout in milliseconds"
	default 5000
	help
	  Caps the DTLS handshake retransmission backoff, to avoid blocking
	  for up to a minute.

config COAP_SAMPLE_CA_CERT_FILE
	string "CA certificate file (PEM)"
	default "cert/cf-ca.pem"
	help
	  Path to the CA certificate used to verify the server.
	  Relative to the sample root directory.

config COAP_SAMPLE_CLIENT_CERT_FILE
	string "Client certificate file (PEM)"
	default "cert/cf-client.pem"
	help
	  Path to the client certificate presented during mutual TLS.

config COAP_SAMPLE_CLIENT_KEY_FILE
	string "Client private key file (PEM)"
	default "cert/cf-client-key.pem"
	help
	  Path to the client private key.

endif # COAP_SAMPLE_DTLS

endmenu

menu "Zephyr Kernel"
source "Kconfig.zephyr"
endmenu

module = COAP_CLIENT_SAMPLE
module-str = CoAP client sample
source "$(ZEPHYR_BASE)/subsys/logging/Kconfig.template.log_config"
```

## Kconfig.sysbuild
```
#
# Copyright (c) 2024 Nordic Semiconductor ASA
# Copyright (c) 2016-2026 Makerdiary <https://makerdiary.com>
#
# SPDX-License-Identifier: LicenseRef-Nordic-5-Clause
#

config PARTITION_MANAGER
	default n

source "share/sysbuild/Kconfig"
```

## sample.yaml
```
sample:
  name: CoAP client sample
tests:
  sample.coap_client:
    sysbuild: true
    build_only: true
    integration_platforms:
      - nrf9151_connectkit/nrf9151/ns
```

## prj.conf
```kconfig
#
# Copyright (c) 2019 Nordic Semiconductor ASA
# Copyright (c) 2016-2026 Makerdiary <https://makerdiary.com>
#
# SPDX-License-Identifier: LicenseRef-Nordic-5-Clause
#

# General
CONFIG_LOG=y
CONFIG_ASSERT=y
CONFIG_REBOOT=y
CONFIG_MAIN_STACK_SIZE=4096

# Networking
CONFIG_NETWORKING=y
CONFIG_NET_SOCKETS=y
CONFIG_POSIX_API=y
CONFIG_NET_NATIVE=y
CONFIG_NET_UDP=y
CONFIG_NET_IPV4=y
CONFIG_NET_CONNECTION_MANAGER=y

# CoAP
CONFIG_COAP=y
CONFIG_COAP_CLIENT=y
CONFIG_COAP_CLIENT_THREAD_PRIORITY=10
CONFIG_COAP_CLIENT_MESSAGE_SIZE=512
CONFIG_COAP_CLIENT_MESSAGE_HEADER_SIZE=64

# Needed for IPv6
CONFIG_COAP_CLIENT_STACK_SIZE=2048
```

## boards/nrf9151_connectkit_nrf9151_ns.conf
```kconfig
#
# Copyright (c) 2024 Nordic Semiconductor ASA
# Copyright (c) 2016-2026 Makerdiary <https://makerdiary.com>
#
# SPDX-License-Identifier: LicenseRef-Nordic-5-Clause
#

# Configuration file for nRF9151 DK
# This file is merged with prj.conf in the application folder, and options
# set here will take precedence if they are present in both files.

# TF-M
CONFIG_TFM_PROFILE_TYPE_MINIMAL=y

# General
CONFIG_HW_ID_LIBRARY_SOURCE_IMEI=y

# Disable Duplicate Address Detection (DAD)
# due to not being properly implemented for offloaded interfaces.
CONFIG_NET_IPV6_NBR_CACHE=n
CONFIG_NET_IPV6_MLD=n

# Zephyr NET Connection Manager and Connectivity layer.
CONFIG_NRF_MODEM_LIB_NET_IF=y
```

## src/main.c
```c
/*
 * Copyright (c) 2019 Nordic Semiconductor ASA
 * Copyright (c) 2016-2026 Makerdiary <https://makerdiary.com>
 *
 * SPDX-License-Identifier: LicenseRef-Nordic-5-Clause
 */

#include <stdio.h>
#include <string.h>

#if defined(CONFIG_POSIX_API)
#include <zephyr/posix/arpa/inet.h>
#include <zephyr/posix/netdb.h>
#include <zephyr/posix/sys/socket.h>
#include <zephyr/posix/poll.h>
#else
#include <zephyr/net/socket.h>
#endif /* CONFIG_POSIX_API */

#include <zephyr/kernel.h>
#include <zephyr/sys/reboot.h>
#include <zephyr/net/coap.h>
#include <zephyr/net/socket.h>
#include <zephyr/net/conn_mgr_connectivity.h>
#include <zephyr/net/conn_mgr_monitor.h>
#include <zephyr/random/random.h>
#include <zephyr/net/coap_client.h>
#include <zephyr/logging/log.h>
#include <zephyr/logging/log_ctrl.h>
#include <zephyr/net/tls_credentials.h>

/* CONFIG_COAP_SAMPLE_DTLS_SEC_TAG and CONFIG_COAP_SAMPLE_DTLS_HANDSHAKE_TIMEOUT_MAX_MS
 * are defined in Kconfig under "if COAP_SAMPLE_DTLS", so they don't exist at all when
 * CONFIG_COAP_SAMPLE_DTLS is disabled. Provide fallback values so the code referencing
 * them below compiles unconditionally; the IS_ENABLED(CONFIG_COAP_SAMPLE_DTLS) runtime
 * check ensures they are never actually used in that case.
 */
#ifndef CONFIG_COAP_SAMPLE_DTLS_SEC_TAG
#define CONFIG_COAP_SAMPLE_DTLS_SEC_TAG 0
#endif
#ifndef CONFIG_COAP_SAMPLE_DTLS_HANDSHAKE_TIMEOUT_MAX_MS
#define CONFIG_COAP_SAMPLE_DTLS_HANDSHAKE_TIMEOUT_MAX_MS 0
#endif

LOG_MODULE_REGISTER(coap_client_sample, CONFIG_COAP_CLIENT_SAMPLE_LOG_LEVEL);

/* Macros used to subscribe to specific Zephyr NET management events. */
#define L4_EVENT_MASK (NET_EVENT_L4_CONNECTED | NET_EVENT_L4_DISCONNECTED)
#define CONN_LAYER_EVENT_MASK (NET_EVENT_CONN_IF_FATAL_ERROR)

#define MAX_CONSECUTIVE_BUSY_RETRIES 5

/* Macro called upon a fatal error, reboots the device. */
#define FATAL_ERROR()					\
	LOG_ERR("Fatal error! Rebooting the device.");	\
	LOG_PANIC();					\
	IF_ENABLED(CONFIG_REBOOT, (sys_reboot(0)))

/* Zephyr NET management event callback structures. */
static struct net_mgmt_event_callback l4_cb;
static struct net_mgmt_event_callback conn_cb;

/* Variable used to indicate if network is connected. */
static bool is_connected;

/* Mutex and conditional variable used to signal network connectivity. */
K_MUTEX_DEFINE(network_connected_lock);
K_CONDVAR_DEFINE(network_connected);

static void server_addr_set_ipv4(struct sockaddr_storage *server, struct addrinfo *result)
{
	struct sockaddr_in *server4 = (struct sockaddr_in *)server;
	char addr_str[NET_IPV6_ADDR_LEN];

	server4->sin_addr.s_addr = ((struct sockaddr_in *)result->ai_addr)->sin_addr.s_addr;
	server4->sin_family = AF_INET;
	server4->sin_port = htons(CONFIG_COAP_SAMPLE_SERVER_PORT);

	inet_ntop(AF_INET, &server4->sin_addr.s_addr, addr_str, sizeof(addr_str));
	LOG_INF("IPv4 Address found %s", addr_str);
}

static void server_addr_set_ipv6(struct sockaddr_storage *server, struct addrinfo *result)
{
	struct sockaddr_in6 *server6 = (struct sockaddr_in6 *)server;
	char addr_str[NET_IPV6_ADDR_LEN];

	memcpy(&server6->sin6_addr,
	       &((struct sockaddr_in6 *)result->ai_addr)->sin6_addr,
	       sizeof(server6->sin6_addr));
	server6->sin6_family = AF_INET6;
	server6->sin6_port = htons(CONFIG_COAP_SAMPLE_SERVER_PORT);

	inet_ntop(AF_INET6, &server6->sin6_addr, addr_str, sizeof(addr_str));
	LOG_INF("IPv6 Address found %s", addr_str);
}

static int server_resolve(struct sockaddr_storage *server)
{
	int err;
	struct addrinfo *result;
	struct addrinfo hints = {
		.ai_family = AF_UNSPEC,
		.ai_socktype = SOCK_DGRAM
	};

	err = getaddrinfo(CONFIG_COAP_SAMPLE_SERVER_HOSTNAME, NULL, &hints, &result);
	if (err) {
		LOG_ERR("getaddrinfo, error: %d", err);
		return err;
	}

	if (result == NULL) {
		LOG_ERR("Address not found");
		return -ENOENT;
	}

	/* Resolve either IPv4 or IPv6 */
	switch (result->ai_family) {
	case AF_INET:
		server_addr_set_ipv4(server, result);
		break;
	case AF_INET6:
		if (IS_ENABLED(CONFIG_NET_IPV6)) {
			server_addr_set_ipv6(server, result);
			break;
		}
		__fallthrough;
	default:
		LOG_ERR("Unexpected address family: %d", result->ai_family);
		freeaddrinfo(result);
		return -EAFNOSUPPORT;
	}

	/* Free the address. */
	freeaddrinfo(result);

	return 0;
}

static void wait_for_network(void)
{
	k_mutex_lock(&network_connected_lock, K_FOREVER);

	if (!is_connected) {
		LOG_INF("Waiting for network connectivity");
		k_condvar_wait(&network_connected, &network_connected_lock, K_FOREVER);
	}

	k_mutex_unlock(&network_connected_lock);
}

static void response_cb(const struct coap_client_response_data *data, void *user_data)
{
	if (data->result_code >= 0) {
		LOG_INF("CoAP response: code: 0x%x, payload: %s",
			data->result_code, data->payload);
	} else {
		LOG_INF("Response received with error code: %d", data->result_code);
	}
}

static int credentials_add(void)
{
	int err;

	if (IS_ENABLED(CONFIG_COAP_SAMPLE_DTLS)) {
		static const char ca_cert[] = {
#if defined(CONFIG_COAP_SAMPLE_DTLS)
			#include "coap_sample_ca_cert.inc"
			'\0'
#endif
		};
		static const char client_cert[] = {
#if defined(CONFIG_COAP_SAMPLE_DTLS)
			#include "coap_sample_client_cert.inc"
			'\0'
#endif
		};
		static const char client_key[] = {
#if defined(CONFIG_COAP_SAMPLE_DTLS)
			#include "coap_sample_client_key.inc"
			'\0'
#endif
		};

		err = tls_credential_add(CONFIG_COAP_SAMPLE_DTLS_SEC_TAG,
					 TLS_CREDENTIAL_CA_CERTIFICATE,
					 ca_cert, sizeof(ca_cert));
		if ((err < 0) && (err != -EEXIST)) {
			LOG_ERR("Failed to register CA certificate: %d", err);
			FATAL_ERROR();
			return err;
		}

		err = tls_credential_add(CONFIG_COAP_SAMPLE_DTLS_SEC_TAG,
					 TLS_CREDENTIAL_PUBLIC_CERTIFICATE,
					 client_cert, sizeof(client_cert));
		if ((err < 0) && (err != -EEXIST)) {
			LOG_ERR("Failed to register client certificate: %d", err);
			FATAL_ERROR();
			return err;
		}

		err = tls_credential_add(CONFIG_COAP_SAMPLE_DTLS_SEC_TAG,
					 TLS_CREDENTIAL_PRIVATE_KEY,
					 client_key, sizeof(client_key));
		if ((err < 0) && (err != -EEXIST)) {
			LOG_ERR("Failed to register private key: %d", err);
			FATAL_ERROR();
			return err;
		}
	}

	return 0;
}

/* Resolves the server and opens a socket to it, performing the DTLS handshake if enabled.
 * Returns the socket on success, or a negative error code on a recoverable failure.
 */
static int server_connect(struct sockaddr_storage *server)
{
	int err, sock;

	err = server_resolve(server);
	if (err) {
		LOG_ERR("Failed to resolve server name");
		return err;
	}

	sock = socket(server->ss_family, SOCK_DGRAM,
		      IS_ENABLED(CONFIG_COAP_SAMPLE_DTLS) ? IPPROTO_DTLS_1_2 : IPPROTO_UDP);
	if (sock < 0) {
		LOG_ERR("Failed to create CoAP socket: %d.", -errno);
		FATAL_ERROR();
		return -errno;
	}

	if (IS_ENABLED(CONFIG_COAP_SAMPLE_DTLS)) {
		sec_tag_t sec_tag_list[] = { CONFIG_COAP_SAMPLE_DTLS_SEC_TAG };

		err = setsockopt(sock, SOL_TLS, TLS_SEC_TAG_LIST,
				 sec_tag_list, sizeof(sec_tag_list));
		if (err < 0) {
			LOG_ERR("Failed to set TLS_SEC_TAG_LIST: %d", -errno);
			(void)zsock_close(sock);
			FATAL_ERROR();
			return -errno;
		}

		uint32_t handshake_timeout_ms = CONFIG_COAP_SAMPLE_DTLS_HANDSHAKE_TIMEOUT_MAX_MS;

		err = setsockopt(sock, SOL_TLS, TLS_DTLS_HANDSHAKE_TIMEOUT_MAX,
				 &handshake_timeout_ms, sizeof(handshake_timeout_ms));
		if (err < 0) {
			LOG_ERR("Failed to set TLS_DTLS_HANDSHAKE_TIMEOUT_MAX: %d", -errno);
			(void)zsock_close(sock);
			FATAL_ERROR();
			return -errno;
		}

		/* Set the expected server hostname for SNI and server certificate
		 * CN/SAN verification.
		 */
		err = setsockopt(sock, SOL_TLS, TLS_HOSTNAME,
				 CONFIG_COAP_SAMPLE_SERVER_HOSTNAME,
				 sizeof(CONFIG_COAP_SAMPLE_SERVER_HOSTNAME) - 1);
		if (err < 0) {
			LOG_ERR("Failed to set TLS_HOSTNAME: %d", -errno);
			(void)zsock_close(sock);
			FATAL_ERROR();
			return -errno;
		}

		/* Explicitly connect to trigger the DTLS handshake now so we can log
		 * the outcome and negotiated ciphersuite before handing the socket to
		 * the CoAP client.
		 */
		LOG_INF("Performing DTLS handshake with %s:%d (mutual TLS)...",
			CONFIG_COAP_SAMPLE_SERVER_HOSTNAME,
			CONFIG_COAP_SAMPLE_SERVER_PORT);

		err = zsock_connect(sock, (struct sockaddr *)server,
				    server->ss_family == AF_INET6 ?
					    sizeof(struct sockaddr_in6) :
					    sizeof(struct sockaddr_in));
		if (err < 0) {
			err = -errno;
			LOG_ERR("DTLS handshake failed: %d", err);
			(void)zsock_close(sock);
			return err;
		}

		int cipher_id;
		socklen_t cipher_id_len = sizeof(cipher_id);

		err = getsockopt(sock, SOL_TLS, TLS_CIPHERSUITE_USED, &cipher_id, &cipher_id_len);
		if (err == 0) {
			LOG_INF("DTLS handshake complete, ciphersuite: 0x%04x", cipher_id);
		} else {
			LOG_INF("DTLS handshake complete (ciphersuite unknown, getsockopt err %d)",
				-errno);
		}
	}

	return sock;
}

static void server_disconnect(struct coap_client *coap_client, int *sock)
{
	coap_client_cancel_requests(coap_client);
	(void)zsock_close(*sock);
	*sock = -1;
}

/* Only returns on fatal errors. Recoverable errors close the socket and reconnect. */
static int periodic_coap_request_loop(void)
{
	int err;
	int sock = -1;
	int consecutive_busy_retries = 0;
	struct sockaddr_storage server = { 0 };
	struct coap_client coap_client = { 0 };
	struct coap_client_request req = {
		.method = COAP_METHOD_GET,
		.confirmable = true,
		.fmt = COAP_CONTENT_FORMAT_TEXT_PLAIN,
		.payload = NULL,
		.cb = response_cb,
		.len = 0,
		.path = CONFIG_COAP_SAMPLE_RESOURCE,
	};

	err = credentials_add();
	if (err) {
		return err;
	}

	err = coap_client_init(&coap_client, NULL);
	if (err) {
		LOG_ERR("Failed to initialize CoAP client: %d", err);
		FATAL_ERROR();
		return err;
	}

	while (true) {
		wait_for_network();

		if (sock < 0) {
			sock = server_connect(&server);
			if (sock < 0) {
				LOG_WRN("Failed to connect to server: %d, retrying in %d seconds",
					sock, CONFIG_SAMPLE_RECONNECT_DELAY_SECONDS);
				k_sleep(K_SECONDS(CONFIG_SAMPLE_RECONNECT_DELAY_SECONDS));
				continue;
			}
		}

		/* Send request */
		err = coap_client_req(&coap_client, sock, (struct sockaddr *)&server, &req, NULL);
		if (err == -EAGAIN &&
		    ++consecutive_busy_retries < MAX_CONSECUTIVE_BUSY_RETRIES) {
			LOG_WRN("CoAP client busy, retrying later");
			k_sleep(K_SECONDS(CONFIG_COAP_SAMPLE_REQUEST_INTERVAL_SECONDS));
			continue;
		}

		consecutive_busy_retries = 0;

		if (err) {
			LOG_ERR("Failed to send request: %d, reconnecting", err);
			server_disconnect(&coap_client, &sock);
			k_sleep(K_SECONDS(CONFIG_SAMPLE_RECONNECT_DELAY_SECONDS));
			continue;
		}

		LOG_INF("CoAP GET request sent to %s:%d, resource: %s",
			CONFIG_COAP_SAMPLE_SERVER_HOSTNAME,
			CONFIG_COAP_SAMPLE_SERVER_PORT,
			CONFIG_COAP_SAMPLE_RESOURCE);

		k_sleep(K_SECONDS(CONFIG_COAP_SAMPLE_REQUEST_INTERVAL_SECONDS));
	}
}

static void l4_event_handler(struct net_mgmt_event_callback *cb,
			     uint64_t event,
			     struct net_if *iface)
{
	switch (event) {
	case NET_EVENT_L4_CONNECTED:
		LOG_INF("Network connectivity established");
		k_mutex_lock(&network_connected_lock, K_FOREVER);
		is_connected = true;
		k_condvar_signal(&network_connected);
		k_mutex_unlock(&network_connected_lock);
		break;
	case NET_EVENT_L4_DISCONNECTED:
		LOG_INF("Network connectivity lost");
		k_mutex_lock(&network_connected_lock, K_FOREVER);
		is_connected = false;
		k_mutex_unlock(&network_connected_lock);
		break;
	default:
		/* Don't care */
		return;
	}
}
static void connectivity_event_handler(struct net_mgmt_event_callback *cb,
						uint64_t event,
						struct net_if *iface)
{
	if (event == NET_EVENT_CONN_IF_FATAL_ERROR) {
		LOG_ERR("NET_EVENT_CONN_IF_FATAL_ERROR");
		FATAL_ERROR();
		return;
	}
}

int main(void)
{
	int err;

	LOG_INF("The CoAP client sample started");

	/* Setup handler for Zephyr NET Connection Manager events and Connectivity layer. */
	net_mgmt_init_event_callback(&l4_cb, l4_event_handler, L4_EVENT_MASK);
	net_mgmt_add_event_callback(&l4_cb);

	net_mgmt_init_event_callback(&conn_cb, connectivity_event_handler, CONN_LAYER_EVENT_MASK);
	net_mgmt_add_event_callback(&conn_cb);

	/* Bring all network interfaces up.
	 * Wi-Fi or LTE depending on the board that the sample was built for.
	 */
	LOG_INF("Bringing network interface up and connecting to the network");

	err = conn_mgr_all_if_up(true);
	if (err) {
		LOG_ERR("conn_mgr_all_if_up, error: %d", err);
		FATAL_ERROR();
		return err;
	}

	err = conn_mgr_all_if_connect(true);
	if (err) {
		LOG_ERR("conn_mgr_all_if_connect, error: %d", err);
		FATAL_ERROR();
		return err;
	}

	/* Resend connection status if the sample is built for NATIVE_SIM.
	 * This is necessary because the network interface is automatically brought up
	 * at SYS_INIT() before main() is called.
	 * This means that NET_EVENT_L4_CONNECTED fires before the
	 * appropriate handler l4_event_handler() is registered.
	 */
	if (IS_ENABLED(CONFIG_BOARD_NATIVE_SIM)) {
		conn_mgr_mon_resend_status();
	}

	wait_for_network();

	err = periodic_coap_request_loop();
	if (err) {
		LOG_ERR("periodic_coap_request_loop, error: %d", err);
	}

	LOG_INF("Bringing network interfaces down");
	(void)conn_mgr_all_if_disconnect(true);
	(void)conn_mgr_all_if_down(true);

	return err;
}
```
