## CMakeLists.txt
```
#
# Copyright (c) 2016-2026 Makerdiary <https://makerdiary.com>
#
# SPDX-License-Identifier: Apache-2.0
#

cmake_minimum_required(VERSION 3.20.0)
find_package(Zephyr REQUIRED HINTS $ENV{ZEPHYR_BASE})
project(system_off)

target_sources(app PRIVATE src/main.c)
```

## sample.yaml
```
sample:
  name: System OFF Sample
tests:
  sample.system_off:
    sysbuild: true
    build_only: true
    integration_platforms:
      - nrf9151_connectkit/nrf9151/ns
```

## prj.conf
```kconfig
# TF-M config
CONFIG_TFM_PROFILE_TYPE_MINIMAL=y

CONFIG_SERIAL=n
CONFIG_LOG=n

CONFIG_NRF_MODEM_LIB=y
CONFIG_LTE_LINK_CONTROL=y

CONFIG_POWEROFF=y
```

## src/main.c
```c
/*
 * Copyright (c) 2016-2026 Makerdiary <https://makerdiary.com>
 *
 * SPDX-License-Identifier: Apache-2.0
 */

#include <zephyr/kernel.h>
#include <modem/lte_lc.h>
#include <modem/nrf_modem_lib.h>
#include <zephyr/sys/poweroff.h>

int main(void)
{
	nrf_modem_lib_init();

	lte_lc_power_off();

	k_sleep(K_MSEC(100));

	nrf_modem_lib_shutdown();

	sys_poweroff();

	while (1) {
	}

	return 0;
}
```
