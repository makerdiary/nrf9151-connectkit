## CMakeLists.txt
```
#
# Copyright (c) 2016-2026 Makerdiary <https://makerdiary.com>
#
# SPDX-License-Identifier: Apache-2.0
#

cmake_minimum_required(VERSION 3.20.0)

find_package(Zephyr REQUIRED HINTS $ENV{ZEPHYR_BASE})

project(IFMCU)

include(${ZEPHYR_BASE}/samples/subsys/usb/common/common.cmake)

# NORDIC SDK APP START
target_sources(app PRIVATE 
  src/main.c
  src/bq2518x.c
  src/ifmcu_dap.c
  src/ifmcu_power.c
  src/ifmcu_shell.c
  src/ifmcu_uart_bridge.c
  src/led_state.c
  )
# NORDIC SDK APP END
```

## Kconfig
```
#
# Copyright (c) 2016-2026 Makerdiary <https://makerdiary.com>
# SPDX-License-Identifier: Apache-2.0
#

source "samples/subsys/usb/common/Kconfig.sample_usbd"
source "Kconfig.zephyr"

config IFMCU_DAP
	bool "IFMCU DAP"
	default y
	depends on DAP

if IFMCU_DAP

module = IFMCU_DAP
module-str = IFMCU DAP module
source "subsys/logging/Kconfig.template.log_config"

endif # IFMCU_DAP

config IFMCU_UART_BRIDGE
	bool "IFMCU UART bridge"
	default y
	depends on DT_HAS_ZEPHYR_UART_BRIDGE_ENABLED
	select UART_INTERRUPT_DRIVEN
	select RING_BUFFER
	help
	  Enable the UART bridge driver.

config IFMCU_UART_BRIDGE_BUF_SIZE
	int "IFMCU UART bridge buffer size"
	default 512
	depends on IFMCU_UART_BRIDGE
	help
	  Size of the bridge ring buffers in bytes.

if IFMCU_UART_BRIDGE

module = IFMCU_UART_BRIDGE
module-str = IFMCU UART bridge module
source "subsys/logging/Kconfig.template.log_config"

endif # IFMCU_UART_BRIDGE

if LED

module = IFMCU_LEDS
module-str = LED module
source "subsys/logging/Kconfig.template.log_config"

endif # LED

if SHELL

module = IFMCU_SHELL
module-str = IFMCU Shell
source "subsys/logging/Kconfig.template.log_config"

endif # SHELL

if CHARGER

module = IFMCU_CHARGER
module-str = IFMCU Charger
source "subsys/logging/Kconfig.template.log_config"

endif # CHARGER
```

## Kconfig.sysbuild
```
#
# Copyright (c) 2020 Nordic Semiconductor ASA
# Copyright (c) 2016-2026 Makerdiary <https://makerdiary.com>
#
# SPDX-License-Identifier: LicenseRef-Nordic-5-Clause
#

# Do not use partition manager
config PARTITION_MANAGER
	default n

source "${ZEPHYR_BASE}/share/sysbuild/Kconfig"
```

## sample.yaml
```
sample:
  name: IFMCU Firmware
tests:
  applications.ifmcu_firmware:
    sysbuild: true
    build_only: true
    integration_platforms:
      - nrf9151_connectkit/nrf52820
```

## prj.conf
```kconfig
# General
CONFIG_REBOOT=y
CONFIG_POWEROFF=y
CONFIG_DK_LIBRARY=y
CONFIG_GPIO=y
CONFIG_SENSOR=y
CONFIG_PM_DEVICE=y
CONFIG_BOOT_BANNER=n
CONFIG_NCS_BOOT_BANNER=n
CONFIG_HW_STACK_PROTECTION=n
CONFIG_RESET_ON_FATAL_ERROR=y

# USB
CONFIG_USB_DEVICE_STACK_NEXT=y
CONFIG_SAMPLE_USBD_MANUFACTURER="Makerdiary"
CONFIG_SAMPLE_USBD_PRODUCT="IFMCU CMSIS-DAP"
CONFIG_SAMPLE_USBD_PID=0x0204
CONFIG_SAMPLE_USBD_20_EXTENSION_DESC=y

# UART
CONFIG_UART_BRIDGE=n
CONFIG_UART_CONSOLE=n
CONFIG_SERIAL=y
CONFIG_UART_LINE_CTRL=y
CONFIG_UART_USE_RUNTIME_CONFIGURE=y
CONFIG_USBD_CDC_ACM_CLASS=y
CONFIG_CDC_ACM_SERIAL_INITIALIZE_AT_BOOT=n

# DAP
CONFIG_DAP=y
CONFIG_DAP_BACKEND_USB=n
CONFIG_CMSIS_DAP_BOARD_VENDOR="Makerdiary"
CONFIG_CMSIS_DAP_BOARD_NAME="nRF9151 Connect Kit"
CONFIG_CMSIS_DAP_DEVICE_VENDOR="Nordic Semiconductor ASA"
CONFIG_CMSIS_DAP_DEVICE_NAME="NRF91"

# Shell
CONFIG_PRINTK=y
CONFIG_SHELL=y
CONFIG_SHELL_STACK_SIZE=2048
CONFIG_SHELL_BACKEND_SERIAL=y
CONFIG_SHELL_BACKEND_SERIAL_CHECK_DTR=y
CONFIG_SHELL_PROMPT_UART="ifsh:~$ "
CONFIG_APP_VERSION_SHELL=n
CONFIG_DATE_SHELL=n
CONFIG_DEVMEM_SHELL=n
CONFIG_I2C_SHELL=y
CONFIG_SETTINGS_SHELL=y

# Settings
CONFIG_FCB=y
CONFIG_SETTINGS=y
CONFIG_SETTINGS_FCB=y
CONFIG_FLASH=y
CONFIG_FLASH_PAGE_LAYOUT=y
CONFIG_FLASH_MAP=y
CONFIG_MPU_ALLOW_FLASH_WRITE=y

# Logging
CONFIG_LOG=n
```

## src/main.c
```c
/*
 * Copyright (c) 2016-2026 Makerdiary <https://makerdiary.com>
 *
 * SPDX-License-Identifier: Apache-2.0
 */

#include <sample_usbd.h>

#include <stdio.h>
#include <string.h>
#include <zephyr/device.h>
#include <zephyr/drivers/uart/uart_bridge.h>
#include <zephyr/kernel.h>

#include <zephyr/sys/byteorder.h>
#include <zephyr/usb/bos.h>
#include <zephyr/usb/msos_desc.h>
#include <hal/nrf_power.h>
#include <zephyr/dap/dap_link.h>

#include <zephyr/usb/usb_device.h>
#include <zephyr/usb/usbd.h>

#include <zephyr/logging/log.h>
LOG_MODULE_REGISTER(main);

#include "ifmcu_power.h"
#include "msosv2.h"

DAP_LINK_CONTEXT_DEFINE(ifmcu_dap_ctx, DEVICE_DT_GET_ONE(zephyr_swdp_gpio));

const struct device *const uart_bridge = DEVICE_DT_GET_ONE(zephyr_uart_bridge);

static struct usbd_context *ifmcu_usbd;

static void ifmcu_usbd_msg_cb(struct usbd_context *const ctx, const struct usbd_msg *msg)
{
	LOG_INF("USBD message: %s", usbd_msg_type_string(msg->type));

	switch (msg->type) {
	case USBD_MSG_VBUS_READY:
		if (usbd_enable(ctx)) {
			LOG_ERR("Failed to enable device support");
		}
		break;

	case USBD_MSG_VBUS_REMOVED:
		if (usbd_disable(ctx)) {
			LOG_ERR("Failed to disable device support");
		}
		ifmcu_system_off();
		break;

	case USBD_MSG_RESUME:
		break;

	case USBD_MSG_SUSPEND:
		break;

	case USBD_MSG_RESET:
		break;

	case USBD_MSG_UDC_ERROR:
		break;

	case USBD_MSG_STACK_ERROR:
		break;

	case USBD_MSG_CONFIGURATION:
		break;
	case USBD_MSG_CDC_ACM_LINE_CODING:
	case USBD_MSG_CDC_ACM_CONTROL_LINE_STATE:
		uart_bridge_settings_update(msg->dev, uart_bridge);
		break;

	default:
		LOG_ERR("Unexpected USB device message type: %d", msg->type);
		break;
	}
}

int main(void)
{
	int ret;

	ret = dap_link_init(&ifmcu_dap_ctx);
	if (ret) {
		LOG_ERR("Failed to initialize DAP controller, %d", ret);
		return ret;
	}

	ret = dap_link_backend_usb_init(&ifmcu_dap_ctx);
	if (ret) {
		LOG_ERR("Failed to initialize DAP Link USB backend, %d", ret);
		return ret;
	}

	ifmcu_usbd = sample_usbd_setup_device(ifmcu_usbd_msg_cb);
	if (ifmcu_usbd == NULL) {
		LOG_ERR("Failed to setup USB device");
		return -ENODEV;
	}

	ret = usbd_add_descriptor(ifmcu_usbd, &bos_vreq_msosv2);
	if (ret) {
		LOG_ERR("Failed to add MSOSv2 capability descriptor");
		return ret;
	}

	ret = usbd_init(ifmcu_usbd);
	if (ret) {
		LOG_ERR("Failed to initialize device support");
		return ret;
	}

	if (!nrf_power_usbregstatus_vbusdet_get(NRF_POWER)) {
		ifmcu_system_off();
	}

	ret = usbd_enable(ifmcu_usbd);
	if (ret) {
		LOG_ERR("Failed to enable device support");
		return ret;
	}

	return 0;
}
```

## src/bq25180.c
```c
/*
 * Copyright (c) 2016-2026 Makerdiary <https://makerdiary.com>
 *
 * SPDX-License-Identifier: Apache-2.0
 */

#include <stdlib.h>

#include <zephyr/device.h>
#include <zephyr/drivers/i2c.h>
#include <zephyr/drivers/charger.h>
#include <zephyr/sys/util.h>

#include "ifmcu_power.h"
#include "led_state.h"
#include "bq25180.h"

#include <zephyr/logging/log.h>
LOG_MODULE_REGISTER(charger, CONFIG_IFMCU_CHARGER_LOG_LEVEL);

#define BQ25180_ICHG_CTRL 0x04
#define BQ25180_TMR_ILIM  0x08
#define BQ25180_SYS_REG   0x0A

#define BQ25180_ICHG_CHG_DIS 		BIT(7)
#define BQ25180_SYS_REG_CTRL_MSK    GENMASK(7, 5)
#define BQ25180_ILIM_MSK			GENMASK(2, 0)

#define CHARGING_CHECK_INTERVAL	K_MSEC(1000)

struct charger_config {
	struct i2c_dt_spec i2c;
	uint32_t initial_current_microamp;
	uint32_t max_voltage_microvolt;
	uint32_t recharge_voltage_microvolt;
	uint32_t precharge_threshold_voltage_microvolt;
};

static const struct device *chgdev = DEVICE_DT_GET(DT_NODELABEL(charger));

static struct k_work_delayable charging_dwork;

int bq25180_chgdis_set(uint8_t chgdis)
{
	int ret;

	if (!device_is_ready(chgdev)) {
		return -ENODEV;
	}

	ret = charger_charge_enable(chgdev, !chgdis);
	if (ret < 0) {
		return ret;
	}

	return 0;
}

int bq25180_chgdis_get(uint8_t *chgdis)
{
	const struct charger_config *config = chgdev->config;
	const struct i2c_dt_spec *i2c = &config->i2c;
	int ret;
	uint8_t ichg_ctrl;

	if (!device_is_ready(chgdev)) {
		return -ENODEV;
	}

	ret = i2c_reg_read_byte_dt(i2c, BQ25180_ICHG_CTRL, &ichg_ctrl);
	if (ret < 0) {
		return ret;
	}

	*chgdis = (ichg_ctrl & BQ25180_ICHG_CHG_DIS)? 1 : 0;

	return 0;
}

int bq25180_sysreg_set(uint8_t mode)
{
	const struct charger_config *config = chgdev->config;
	const struct i2c_dt_spec *i2c = &config->i2c;
	int ret;

	if (!device_is_ready(chgdev)) {
		return -ENODEV;
	}

	mode = FIELD_PREP(BQ25180_SYS_REG_CTRL_MSK, mode);

	ret = i2c_reg_update_byte_dt(i2c, BQ25180_SYS_REG, BQ25180_SYS_REG_CTRL_MSK, mode);
	if (ret < 0) {
		return ret;
	}

	return 0;
}

int bq25180_sysreg_get(uint8_t *mode)
{
	const struct charger_config *config = chgdev->config;
	const struct i2c_dt_spec *i2c = &config->i2c;
	int ret;
	uint8_t sysreg_ctrl;

	if (!device_is_ready(chgdev)) {
		return -ENODEV;
	}

	ret = i2c_reg_read_byte_dt(i2c, BQ25180_SYS_REG, &sysreg_ctrl);
	if (ret < 0) {
		return ret;
	}

	*mode = FIELD_GET(BQ25180_SYS_REG_CTRL_MSK, sysreg_ctrl);

	return 0;
}

int bq25180_ichg_set(uint32_t current_ma)
{
	int ret;
	union charger_propval val;

	if (!device_is_ready(chgdev)) {
		return -ENODEV;
	}

	val.const_charge_current_ua = current_ma * 1000;

	ret = charger_set_prop(chgdev, CHARGER_PROP_CONSTANT_CHARGE_CURRENT_UA, &val);

	return ret;
}

int bq25180_ichg_get(uint32_t *current_ma)
{
	int ret;
	union charger_propval val;

	if (!device_is_ready(chgdev)) {
		return -ENODEV;
	}

	ret = charger_get_prop(chgdev, CHARGER_PROP_CONSTANT_CHARGE_CURRENT_UA, &val);
	if (ret < 0) {
		return ret;
	}

	*current_ma = val.const_charge_current_ua / 1000;

	return 0;
}

int bq25180_vbatreg_set(uint32_t voltage_mv)
{
	int ret;
	union charger_propval val;

	if (!device_is_ready(chgdev)) {
		return -ENODEV;
	}

	val.const_charge_voltage_uv = voltage_mv * 1000;

	ret = charger_set_prop(chgdev, CHARGER_PROP_CONSTANT_CHARGE_VOLTAGE_UV, &val);

	return ret;
}

int bq25180_vbatreg_get(uint32_t *voltage_mv)
{
	int ret;
	union charger_propval val;

	if (!device_is_ready(chgdev)) {
		return -ENODEV;
	}

	ret = charger_get_prop(chgdev, CHARGER_PROP_CONSTANT_CHARGE_VOLTAGE_UV, &val);
	if (ret < 0) {
		return ret;
	}

	*voltage_mv = val.const_charge_voltage_uv / 1000;

	return 0;
}

int bq25180_ilim_set(uint8_t level)
{
	const struct charger_config *config = chgdev->config;
	const struct i2c_dt_spec *i2c = &config->i2c;
	int ret;

	if (!device_is_ready(chgdev)) {
		return -ENODEV;
	}

	level = FIELD_PREP(BQ25180_ILIM_MSK, level);

	ret = i2c_reg_update_byte_dt(i2c, BQ25180_TMR_ILIM, BQ25180_ILIM_MSK, level);
	if (ret < 0) {
		return ret;
	}

	return 0;
}

int bq25180_ilim_get(uint8_t *level)
{
	const struct charger_config *config = chgdev->config;
	const struct i2c_dt_spec *i2c = &config->i2c;
	int ret;
	uint8_t ilim;

	if (!device_is_ready(chgdev)) {
		return -ENODEV;
	}

	ret = i2c_reg_read_byte_dt(i2c, BQ25180_TMR_ILIM, &ilim);
	if (ret < 0) {
		return ret;
	}

	*level = FIELD_GET(BQ25180_ILIM_MSK, ilim);

	return 0;
}

int bq25180_status(uint8_t *status)
{
	int ret;
	union charger_propval val;

	ret = charger_get_prop(chgdev, CHARGER_PROP_STATUS, &val);
	if (ret < 0) {
		return ret;
	}

	*status = val.status;

	return 0;

}

static void charging_dwork_handler(struct k_work *work)
{
	int ret;
	union charger_propval val0, val1;

	ret = charger_get_prop(chgdev, CHARGER_PROP_ONLINE, &val0);
	if (ret < 0) {
		LOG_ERR("Could not get the charger online property. (rc: %d)", ret);
		goto out;
	}

	ret = charger_get_prop(chgdev, CHARGER_PROP_STATUS, &val1);
	if (ret < 0) {
		LOG_ERR("Could not get the charger status property. (rc: %d)", ret);
		goto out;
	}

	if (val0.online == CHARGER_ONLINE_OFFLINE) {
		/* Put the chip in SYSTEM OFF mode, to be rebooted when USB is connected. */
		ifmcu_system_off();
	} else {
		set_pgood_led_state(LED_STATE_ON);
		if (val1.status == CHARGER_STATUS_CHARGING) {
			set_charger_led_state(LED_STATE_BREATH);
		} else if (val1.status == CHARGER_STATUS_FULL) {
			set_charger_led_state(LED_STATE_OFF);
		} else {
			LOG_WRN("unknown charger state: oneline=%d status=%d",
				val0.online, val1.status);
			goto out;
		}
	}

out:
    k_work_schedule(&charging_dwork, CHARGING_CHECK_INTERVAL);
}


int bq25180_init(void)
{
	if (!device_is_ready(chgdev)) {
		LOG_ERR("Charger device is not ready");
		return -ENODEV;
	}

	k_work_init_delayable(&charging_dwork, charging_dwork_handler);
	charging_dwork_handler(&charging_dwork.work);

	return 0;
}
```

## src/bq25180.h
```c
/*
 * Copyright (c) 2016-2026 Makerdiary <https://makerdiary.com>
 *
 * SPDX-License-Identifier: Apache-2.0
 */

#ifndef _BQ25180_H_
#define _BQ25180_H_

#ifdef __cplusplus
extern "C" {
#endif

int bq25180_init(void);
int bq25180_chgdis_set(uint8_t chgdis);
int bq25180_chgdis_get(uint8_t *chgdis);
int bq25180_sysreg_set(uint8_t mode);
int bq25180_sysreg_get(uint8_t *mode);
int bq25180_ichg_set(uint32_t current_ma);
int bq25180_ichg_get(uint32_t *current_ma);
int bq25180_vbatreg_set(uint32_t voltage_mv);
int bq25180_vbatreg_get(uint32_t *voltage_mv);
int bq25180_ilim_set(uint8_t level);
int bq25180_ilim_get(uint8_t *level);
int bq25180_status(uint8_t *status);

#ifdef __cplusplus
}
#endif

#endif /* _BQ25180_H_ */
```

## src/bq2518x.c
```c
/*
 * Copyright (c) 2016-2026 Makerdiary <https://makerdiary.com>
 *
 * SPDX-License-Identifier: Apache-2.0
 */

#include <stdlib.h>

#include <zephyr/device.h>
#include <zephyr/drivers/i2c.h>
#include <zephyr/drivers/gpio.h>
#include <zephyr/drivers/charger.h>
#include <zephyr/sys/util.h>

#include "ifmcu_power.h"
#include "led_state.h"
#include "bq2518x.h"

#include <zephyr/logging/log.h>
LOG_MODULE_REGISTER(charger, CONFIG_IFMCU_CHARGER_LOG_LEVEL);

#define BQ2518X_ICHG_CTRL 			0x04
#define BQ2518X_TMR_ILIM  			0x08
#define BQ2518X_SYS_REG   			0x0A
#define BQ2518X_MASK_ID   			0x0C

#define BQ2518X_ICHG_CHG_DIS 		BIT(7)
#define BQ2518X_SYS_REG_CTRL_MSK    GENMASK(7, 5)
#define BQ2518X_ILIM_MSK			GENMASK(2, 0)
#define BQ2518X_DEVICE_ID_MSK       GENMASK(3, 0)

#define CHARGING_CHECK_INTERVAL		K_MSEC(1000)

struct charger_config {
	struct i2c_dt_spec i2c;
	struct gpio_dt_spec int_gpio;
	uint32_t initial_current_microamp;
	uint32_t max_voltage_microvolt;
	uint8_t reg_ic_ctrl;
	uint8_t reg_charge_control1;
	uint8_t reg_sys_regulation;
	uint8_t termination_current;
};

static const struct device *chgdev = DEVICE_DT_GET(DT_NODELABEL(charger));

static struct k_work_delayable charging_dwork;

int bq2518x_chgdis_set(uint8_t chgdis)
{
	int ret;

	if (!device_is_ready(chgdev)) {
		return -ENODEV;
	}

	ret = charger_charge_enable(chgdev, !chgdis);
	if (ret < 0) {
		return ret;
	}

	return 0;
}

int bq2518x_chgdis_get(uint8_t *chgdis)
{
	const struct charger_config *config = chgdev->config;
	const struct i2c_dt_spec *i2c = &config->i2c;
	int ret;
	uint8_t ichg_ctrl;

	if (!device_is_ready(chgdev)) {
		return -ENODEV;
	}

	ret = i2c_reg_read_byte_dt(i2c, BQ2518X_ICHG_CTRL, &ichg_ctrl);
	if (ret < 0) {
		return ret;
	}

	*chgdis = (ichg_ctrl & BQ2518X_ICHG_CHG_DIS)? 1 : 0;

	return 0;
}

int bq2518x_sysreg_set(uint8_t mode)
{
	const struct charger_config *config = chgdev->config;
	const struct i2c_dt_spec *i2c = &config->i2c;
	int ret;

	if (!device_is_ready(chgdev)) {
		return -ENODEV;
	}

	mode = FIELD_PREP(BQ2518X_SYS_REG_CTRL_MSK, mode);

	ret = i2c_reg_update_byte_dt(i2c, BQ2518X_SYS_REG, BQ2518X_SYS_REG_CTRL_MSK, mode);
	if (ret < 0) {
		return ret;
	}

	return 0;
}

int bq2518x_sysreg_get(uint8_t *mode)
{
	const struct charger_config *config = chgdev->config;
	const struct i2c_dt_spec *i2c = &config->i2c;
	int ret;
	uint8_t sysreg_ctrl;

	if (!device_is_ready(chgdev)) {
		return -ENODEV;
	}

	ret = i2c_reg_read_byte_dt(i2c, BQ2518X_SYS_REG, &sysreg_ctrl);
	if (ret < 0) {
		return ret;
	}

	*mode = FIELD_GET(BQ2518X_SYS_REG_CTRL_MSK, sysreg_ctrl);

	return 0;
}

int bq2518x_ichg_set(uint32_t current_ma)
{
	int ret;
	union charger_propval val;

	if (!device_is_ready(chgdev)) {
		return -ENODEV;
	}

	val.const_charge_current_ua = current_ma * 1000;

	ret = charger_set_prop(chgdev, CHARGER_PROP_CONSTANT_CHARGE_CURRENT_UA, &val);

	return ret;
}

int bq2518x_ichg_get(uint32_t *current_ma)
{
	int ret;
	union charger_propval val;

	if (!device_is_ready(chgdev)) {
		return -ENODEV;
	}

	ret = charger_get_prop(chgdev, CHARGER_PROP_CONSTANT_CHARGE_CURRENT_UA, &val);
	if (ret < 0) {
		return ret;
	}

	*current_ma = val.const_charge_current_ua / 1000;

	return 0;
}

int bq2518x_vbatreg_set(uint32_t voltage_mv)
{
	int ret;
	union charger_propval val;

	if (!device_is_ready(chgdev)) {
		return -ENODEV;
	}

	val.const_charge_voltage_uv = voltage_mv * 1000;

	ret = charger_set_prop(chgdev, CHARGER_PROP_CONSTANT_CHARGE_VOLTAGE_UV, &val);

	return ret;
}

int bq2518x_vbatreg_get(uint32_t *voltage_mv)
{
	int ret;
	union charger_propval val;

	if (!device_is_ready(chgdev)) {
		return -ENODEV;
	}

	ret = charger_get_prop(chgdev, CHARGER_PROP_CONSTANT_CHARGE_VOLTAGE_UV, &val);
	if (ret < 0) {
		return ret;
	}

	*voltage_mv = val.const_charge_voltage_uv / 1000;

	return 0;
}

int bq2518x_ilim_set(uint8_t level)
{
	const struct charger_config *config = chgdev->config;
	const struct i2c_dt_spec *i2c = &config->i2c;
	int ret;

	if (!device_is_ready(chgdev)) {
		return -ENODEV;
	}

	level = FIELD_PREP(BQ2518X_ILIM_MSK, level);

	ret = i2c_reg_update_byte_dt(i2c, BQ2518X_TMR_ILIM, BQ2518X_ILIM_MSK, level);
	if (ret < 0) {
		return ret;
	}

	return 0;
}

int bq2518x_ilim_get(uint8_t *level)
{
	const struct charger_config *config = chgdev->config;
	const struct i2c_dt_spec *i2c = &config->i2c;
	int ret;
	uint8_t ilim;

	if (!device_is_ready(chgdev)) {
		return -ENODEV;
	}

	ret = i2c_reg_read_byte_dt(i2c, BQ2518X_TMR_ILIM, &ilim);
	if (ret < 0) {
		return ret;
	}

	*level = FIELD_GET(BQ2518X_ILIM_MSK, ilim);

	return 0;
}

int bq2518x_status(uint8_t *status)
{
	int ret;
	union charger_propval val;

	ret = charger_get_prop(chgdev, CHARGER_PROP_STATUS, &val);
	if (ret < 0) {
		return ret;
	}

	*status = val.status;

	return 0;
}

int bq2518x_devid(uint8_t *devid)
{

	const struct charger_config *config = chgdev->config;
	const struct i2c_dt_spec *i2c = &config->i2c;
	uint8_t val;
	int ret;

	if (!device_is_ready(chgdev)) {
		return -ENODEV;
	}

	ret = i2c_reg_read_byte_dt(i2c, BQ2518X_MASK_ID, &val);
	if (ret < 0) {
		return ret;
	}

	val &= BQ2518X_DEVICE_ID_MSK;
	if (!((val == BQ25180_DEVICE_ID) || (val == BQ25186_DEVICE_ID) || (val == BQ25188_DEVICE_ID))) {
		return -EINVAL;
	}

	*devid = val;

	return 0;
}

static void charging_dwork_handler(struct k_work *work)
{
	int ret;
	union charger_propval val0, val1;

	ret = charger_get_prop(chgdev, CHARGER_PROP_ONLINE, &val0);
	if (ret < 0) {
		LOG_ERR("Could not get the charger online property. (rc: %d)", ret);
		goto out;
	}

	ret = charger_get_prop(chgdev, CHARGER_PROP_STATUS, &val1);
	if (ret < 0) {
		LOG_ERR("Could not get the charger status property. (rc: %d)", ret);
		goto out;
	}

	if (val0.online == CHARGER_ONLINE_OFFLINE) {
		/* Put the chip in SYSTEM OFF mode, to be rebooted when USB is connected. */
		ifmcu_system_off();
	} else {
		set_pgood_led_state(LED_STATE_ON);
		if (val1.status == CHARGER_STATUS_CHARGING) {
			set_charger_led_state(LED_STATE_BREATH);
		} else if (val1.status == CHARGER_STATUS_FULL) {
			set_charger_led_state(LED_STATE_OFF);
		} else {
			LOG_WRN("unknown charger state: oneline=%d status=%d",
				val0.online, val1.status);
			goto out;
		}
	}

out:
    k_work_schedule(&charging_dwork, CHARGING_CHECK_INTERVAL);
}


int bq2518x_init(void)
{
	if (!device_is_ready(chgdev)) {
		LOG_ERR("Charger device is not ready");
		return -ENODEV;
	}

	k_work_init_delayable(&charging_dwork, charging_dwork_handler);
	charging_dwork_handler(&charging_dwork.work);

	return 0;
}
```

## src/bq2518x.h
```c
/*
 * Copyright (c) 2016-2026 Makerdiary <https://makerdiary.com>
 *
 * SPDX-License-Identifier: Apache-2.0
 */

#ifndef _BQ2518X_H_
#define _BQ2518X_H_

#ifdef __cplusplus
extern "C" {
#endif

enum bq2518x_device_id {
	BQ25180_DEVICE_ID = 0x00,
	BQ25186_DEVICE_ID = 0x01,
	BQ25188_DEVICE_ID = 0x04,
};

int bq2518x_init(void);
int bq2518x_chgdis_set(uint8_t chgdis);
int bq2518x_chgdis_get(uint8_t *chgdis);
int bq2518x_sysreg_set(uint8_t mode);
int bq2518x_sysreg_get(uint8_t *mode);
int bq2518x_ichg_set(uint32_t current_ma);
int bq2518x_ichg_get(uint32_t *current_ma);
int bq2518x_vbatreg_set(uint32_t voltage_mv);
int bq2518x_vbatreg_get(uint32_t *voltage_mv);
int bq2518x_ilim_set(uint8_t level);
int bq2518x_ilim_get(uint8_t *level);
int bq2518x_status(uint8_t *status);
int bq2518x_devid(uint8_t *devid);

#ifdef __cplusplus
}
#endif

#endif /* _BQ2518X_H_ */
```

## src/ifmcu_dap.c
```c
/*
 * Copyright (c) 2024 Nordic Semiconductor ASA
 * Copyright (c) 2016-2026 Makerdiary <https://makerdiary.com>
 *
 * SPDX-License-Identifier: Apache-2.0
 */

#include <zephyr/usb/usbd.h>
#include <zephyr/drivers/usb/udc.h>
#include <zephyr/sys/byteorder.h>
#include <zephyr/dap/dap_link.h>
#include <zephyr/app_version.h>

#if defined(NCS_APPLICATION_BOOT_BANNER_GIT_REPO)
#include <app_commit.h>
#endif

#include <cmsis_dap.h>

#include "led_state.h"

#include <zephyr/logging/log.h>
LOG_MODULE_REGISTER(ifmcu_dap, CONFIG_IFMCU_DAP_LOG_LEVEL);

/*
 * This file implements CMSIS DAP USB backend function using bulk endpoints.
 */

#define ID_DAP_VENDOR19					(0x80 + 19)
#define ID_DAP_VENDOR20					(0x80 + 20)
#define ID_DAP_VENDOR21					(0x80 + 21)
#define ID_DAP_VENDOR22					(0x80 + 22)

#define ID_DAP_VENDOR_NRF91_RESET	    ID_DAP_VENDOR19
#define ID_DAP_VENDOR_IFMCU_RESET	    ID_DAP_VENDOR20
#define ID_DAP_VENDOR_IFMCU_BOOTLOADER	ID_DAP_VENDOR21
#define ID_DAP_VENDOR_IFMCU_VERSION	    ID_DAP_VENDOR22

#define DAP_COMMAND_SUCCESS				0x00
#define DAP_COMMAND_FAILED				0xFF

extern struct k_work_delayable nrf91_reset_work;
extern struct k_work_delayable ifmcu_reset_work;
extern struct k_work_delayable ifmcu_bootloader_work;

static uint8_t response_buf[512];

NET_BUF_POOL_FIXED_DEFINE(dap_func_pool,
			  1, 0, sizeof(struct udc_buf_info), NULL);

UDC_STATIC_BUF_DEFINE(dap_func_buf, 512);

struct dap_func_desc {
	struct usb_if_descriptor if0;
	struct usb_ep_descriptor if0_out_ep;
	struct usb_ep_descriptor if0_in_ep;
	struct usb_ep_descriptor if0_hs_out_ep;
	struct usb_ep_descriptor if0_hs_in_ep;
	struct usb_desc_header nil_desc;
};

#define SAMPLE_FUNCTION_ENABLED		0

struct dap_func_data {
	struct dap_func_desc *const desc;
	const struct usb_desc_header **const fs_desc;
	const struct usb_desc_header **const hs_desc;
	struct usbd_desc_node *const iface_str_desc_nd;
	atomic_t state;
	struct dap_link_context *dap_link_ctx;
};

static uint8_t dap_func_get_bulk_out(struct usbd_class_data *const c_data)
{
	struct dap_func_data *data = usbd_class_get_private(c_data);
	struct usbd_context *uds_ctx = usbd_class_get_ctx(c_data);
	struct dap_func_desc *desc = data->desc;

	if (usbd_bus_speed(uds_ctx) == USBD_SPEED_HS) {
		return desc->if0_hs_out_ep.bEndpointAddress;
	}

	return desc->if0_out_ep.bEndpointAddress;
}

static uint8_t dap_func_get_bulk_in(struct usbd_class_data *const c_data)
{
	struct dap_func_data *data = usbd_class_get_private(c_data);
	struct usbd_context *uds_ctx = usbd_class_get_ctx(c_data);
	struct dap_func_desc *desc = data->desc;

	if (usbd_bus_speed(uds_ctx) == USBD_SPEED_HS) {
		return desc->if0_hs_in_ep.bEndpointAddress;
	}

	return desc->if0_in_ep.bEndpointAddress;
}

/* This is a placeholder implementation until proper CMSIS-DAP support is available.
 * Only custom vendor commands are supported.
 */
static size_t dap_execute_vendor_cmd(struct dap_link_context *const dap_link_ctx, uint8_t *in,
			      uint8_t *out)
{
	LOG_DBG("got command 0x%02X", in[0]);

	set_dap_led_state(LED_STATE_BLINK);

	if (in[0] < ID_DAP_VENDOR0) {
		return dap_link_execute_cmd(dap_link_ctx, in, out);
	}

	if (in[0] == ID_DAP_VENDOR_IFMCU_BOOTLOADER) {
		if (!k_work_busy_get(&ifmcu_bootloader_work.work)) {
			k_work_reschedule(&ifmcu_bootloader_work, K_NO_WAIT);
		}
		goto success;
	}
	if (in[0] == ID_DAP_VENDOR_IFMCU_RESET) {
		if (!k_work_busy_get(&ifmcu_reset_work.work)) {
			k_work_reschedule(&ifmcu_reset_work, K_NO_WAIT);
		}
		goto success;
	}
	if (in[0] == ID_DAP_VENDOR_NRF91_RESET) {
		if (!k_work_busy_get(&nrf91_reset_work.work)) {
			k_work_reschedule(&nrf91_reset_work, K_NO_WAIT);
		}
		goto success;
	}

	if (in[0] == ID_DAP_VENDOR_IFMCU_VERSION) {
		const size_t VERSION_STRING_LEN = 62U;

		int len = snprintf(out + 2, VERSION_STRING_LEN,
			"Boot: %u.%u.%u, App: "
	        APP_VERSION_STRING
#if defined(NCS_APPLICATION_BOOT_BANNER_GIT_REPO)
	        "-" APP_COMMIT_STRING
#endif
			,
			((NRF_TIMER2->CC[0] >> 16) & 0xFF),
			((NRF_TIMER2->CC[0] >> 8) & 0xFF),
			(NRF_TIMER2->CC[0] & 0xFF));
		if (len < 0 || len >= VERSION_STRING_LEN) {
			LOG_ERR("Failed to format version string");
			goto error;
		}
		out[0] = in[0];
		out[1] = len;
		return len + 2;
	}

error:
	/* default reply: command failed */
	out[0] = in[0];
	out[1] = DAP_COMMAND_FAILED;
	return 2;
success:
	out[0] = in[0];
	out[1] = DAP_COMMAND_SUCCESS;
	return 2;
}


static int dap_func_request_handler(struct usbd_class_data *c_data,
				  struct net_buf *buf, int err)
{
	struct usbd_context *uds_ctx = usbd_class_get_ctx(c_data);
	struct dap_func_data *data = usbd_class_get_private(c_data);
	struct udc_buf_info *bi = NULL;

	bi = (struct udc_buf_info *)net_buf_user_data(buf);
	LOG_DBG("Transfer finished %p -> ep 0x%02x, len %u, err %d",
		(void *)c_data, bi->ep, buf->len, err);

	if (atomic_test_bit(&data->state, SAMPLE_FUNCTION_ENABLED) && err == 0) {
		uint8_t ep = bi->ep;
		size_t len;

		memset(bi, 0, sizeof(struct udc_buf_info));
		if (ep == dap_func_get_bulk_in(c_data)) {
			bi->ep = dap_func_get_bulk_out(c_data);
			net_buf_reset(buf);
		} else {
			bi->ep = dap_func_get_bulk_in(c_data);

			len = dap_execute_vendor_cmd(data->dap_link_ctx,
						   buf->data, response_buf);
			net_buf_reset(buf);
			LOG_DBG("response length %u, starting with [0x%02X, 0x%02X]",
				len, response_buf[0], response_buf[1]);
			net_buf_add_mem(buf, response_buf, MIN(len, net_buf_tailroom(buf)));
		}

		if (usbd_ep_enqueue(c_data, buf)) {
			LOG_ERR("Failed to enqueue buffer");
			usbd_ep_buf_free(uds_ctx, buf);
		}
	} else {
		LOG_ERR("Function is disabled or transfer failed");
		usbd_ep_buf_free(uds_ctx, buf);
	}

	return 0;
}

static void *dap_func_get_desc(struct usbd_class_data *const c_data,
			     const enum usbd_speed speed)
{
	struct dap_func_data *data = usbd_class_get_private(c_data);

	if (speed == USBD_SPEED_HS) {
		return data->hs_desc;
	}

	return data->fs_desc;
}

struct net_buf *dap_func_buf_alloc(struct usbd_class_data *const c_data,
				const uint8_t ep)
{
	struct usbd_context *uds_ctx = usbd_class_get_ctx(c_data);
	struct net_buf *buf = NULL;
	struct udc_buf_info *bi;
	size_t size;

	if (usbd_bus_speed(uds_ctx) == USBD_SPEED_HS) {
		size = 512U;
	} else {
		size = 64U;
	}

	buf = net_buf_alloc_with_data(&dap_func_pool, dap_func_buf, size, K_NO_WAIT);
	net_buf_reset(buf);
	if (!buf) {
		return NULL;
	}

	bi = udc_get_buf_info(buf);
	memset(bi, 0, sizeof(struct udc_buf_info));
	bi->ep = ep;

	return buf;
}

static void dap_func_enable(struct usbd_class_data *const c_data)
{
	struct dap_func_data *data = usbd_class_get_private(c_data);
	struct usbd_context *uds_ctx = usbd_class_get_ctx(c_data);
	struct net_buf *buf;

	LOG_INF("Configuration enabled");

	if (!atomic_test_and_set_bit(&data->state, SAMPLE_FUNCTION_ENABLED)) {
		if (usbd_bus_speed(uds_ctx) == USBD_SPEED_HS) {
			dap_link_set_pkt_size(data->dap_link_ctx, 512);
		} else {
			dap_link_set_pkt_size(data->dap_link_ctx, 64);
		}

		buf = dap_func_buf_alloc(c_data, dap_func_get_bulk_out(c_data));
		if (buf == NULL) {
			LOG_ERR("Failed to allocate buffer");
			return;
		}

		if (usbd_ep_enqueue(c_data, buf)) {
			LOG_ERR("Failed to enqueue buffer");
			usbd_ep_buf_free(uds_ctx, buf);
		}
	}
}

static void dap_func_disable(struct usbd_class_data *const c_data)
{
	struct dap_func_data *data = usbd_class_get_private(c_data);

	atomic_clear_bit(&data->state, SAMPLE_FUNCTION_ENABLED);
	LOG_INF("Configuration disabled");
}

static int dap_func_init(struct usbd_class_data *c_data)
{
	struct usbd_context *uds_ctx = usbd_class_get_ctx(c_data);
	struct dap_func_data *data = usbd_class_get_private(c_data);
	struct dap_func_desc *desc = data->desc;

	if (data->dap_link_ctx == NULL) {
		LOG_ERR("No DAP Link context provided");
		return -EIO;
	}

	LOG_DBG("Init class instance %p", (void *)c_data);

	if (usbd_add_descriptor(uds_ctx, data->iface_str_desc_nd)) {
		LOG_ERR("Failed to add interface string descriptor");
	} else {
		desc->if0.iInterface = usbd_str_desc_get_idx(data->iface_str_desc_nd);
	}

	return 0;
}

struct usbd_class_api dap_func_api = {
	.request = dap_func_request_handler,
	.get_desc = dap_func_get_desc,
	.enable = dap_func_enable,
	.disable = dap_func_disable,
	.init = dap_func_init,
};

#define DAP_FUNC_DESCRIPTOR_DEFINE(n, _)					\
static struct dap_func_desc dap_func_desc_##n = {				\
	/* Interface descriptor 0 */						\
	.if0 = {								\
		.bLength = sizeof(struct usb_if_descriptor),			\
		.bDescriptorType = USB_DESC_INTERFACE,				\
		.bInterfaceNumber = 0,						\
		.bAlternateSetting = 0,						\
		.bNumEndpoints = 2,						\
		.bInterfaceClass = USB_BCC_VENDOR,				\
		.bInterfaceSubClass = 0,					\
		.bInterfaceProtocol = 0,					\
		.iInterface = 0,						\
	},									\
										\
	/* Endpoint OUT */							\
	.if0_out_ep = {								\
		.bLength = sizeof(struct usb_ep_descriptor),			\
		.bDescriptorType = USB_DESC_ENDPOINT,				\
		.bEndpointAddress = 0x01,					\
		.bmAttributes = USB_EP_TYPE_BULK,				\
		.wMaxPacketSize = sys_cpu_to_le16(64U),				\
		.bInterval = 0x00,						\
	},									\
										\
	/* Endpoint IN */							\
	.if0_in_ep = {								\
		.bLength = sizeof(struct usb_ep_descriptor),			\
		.bDescriptorType = USB_DESC_ENDPOINT,				\
		.bEndpointAddress = 0x81,					\
		.bmAttributes = USB_EP_TYPE_BULK,				\
		.wMaxPacketSize = sys_cpu_to_le16(64U),				\
		.bInterval = 0x00,						\
	},									\
										\
	/* High-speed Endpoint OUT */						\
	.if0_hs_out_ep = {							\
		.bLength = sizeof(struct usb_ep_descriptor),			\
		.bDescriptorType = USB_DESC_ENDPOINT,				\
		.bEndpointAddress = 0x01,					\
		.bmAttributes = USB_EP_TYPE_BULK,				\
		.wMaxPacketSize = sys_cpu_to_le16(512),				\
		.bInterval = 0x00,						\
	},									\
										\
	/* High-speed Endpoint IN */						\
	.if0_hs_in_ep = {							\
		.bLength = sizeof(struct usb_ep_descriptor),			\
		.bDescriptorType = USB_DESC_ENDPOINT,				\
		.bEndpointAddress = 0x81,					\
		.bmAttributes = USB_EP_TYPE_BULK,				\
		.wMaxPacketSize = sys_cpu_to_le16(512),				\
		.bInterval = 0x00,						\
	},									\
										\
	/* Termination descriptor */						\
	.nil_desc = {								\
		.bLength = 0,							\
		.bDescriptorType = 0,						\
	},									\
};										\
										\
const static struct usb_desc_header *dap_func_fs_desc_##n[] = {			\
	(struct usb_desc_header *) &dap_func_desc_##n.if0,			\
	(struct usb_desc_header *) &dap_func_desc_##n.if0_out_ep,		\
	(struct usb_desc_header *) &dap_func_desc_##n.if0_in_ep,		\
	(struct usb_desc_header *) &dap_func_desc_##n.nil_desc,			\
};										\
										\
const static struct usb_desc_header *dap_func_hs_desc_##n[] = {			\
	(struct usb_desc_header *) &dap_func_desc_##n.if0,			\
	(struct usb_desc_header *) &dap_func_desc_##n.if0_hs_out_ep,		\
	(struct usb_desc_header *) &dap_func_desc_##n.if0_hs_in_ep,		\
	(struct usb_desc_header *) &dap_func_desc_##n.nil_desc,			\
};


#define DAP_FUNC_FUNCTION_DATA_DEFINE(n, _)					\
	USBD_DESC_STRING_DEFINE(iface_str_desc_nd_##n,				\
				"CMSIS-DAP v2",					\
				USBD_DUT_STRING_INTERFACE);			\
										\
	static struct dap_func_data dap_func_data_##n = {			\
		.desc = &dap_func_desc_##n,					\
		.fs_desc = dap_func_fs_desc_##n,				\
		.hs_desc = dap_func_hs_desc_##n,				\
		.iface_str_desc_nd = &iface_str_desc_nd_##n,			\
	};									\
										\
	USBD_DEFINE_CLASS(dap_func_##n, &dap_func_api, &dap_func_data_##n, NULL);

LISTIFY(1, DAP_FUNC_DESCRIPTOR_DEFINE, ())
LISTIFY(1, DAP_FUNC_FUNCTION_DATA_DEFINE, ())

int dap_link_backend_usb_init(struct dap_link_context *const dap_link_ctx)
{
	struct usbd_class_data *const c_data = &dap_func_0;
	struct dap_func_data *data = usbd_class_get_private(c_data);

	if (atomic_test_bit(&data->state, SAMPLE_FUNCTION_ENABLED)) {
		return -EALREADY;
	}

	data->dap_link_ctx = dap_link_ctx;

	return 0;
}
```

## src/ifmcu_power.c
```c
/*
 * Copyright (c) 2016-2026 Makerdiary <https://makerdiary.com>
 *
 * SPDX-License-Identifier: Apache-2.0
 */

#include <zephyr/kernel.h>
#include <zephyr/sys/poweroff.h>
#include <cmsis_core.h>

#include "led_state.h"
#include "ifmcu_power.h"

void ifmcu_system_off(void)
{
	set_all_leds_off();

	/* Zephyr sets SEVONPEND at boot.  With it set, any pending interrupt
	 * makes the WFE inside nrf_power_system_off() return immediately, so
	 * the CPU never sleeps and the SYSTEMOFF request never takes effect:
	 * the chip spins at ~2 mA instead of powering down.  Clear it first. */
	SCB->SCR &= ~SCB_SCR_SEVONPEND_Msk;
	__DSB();
	sys_poweroff();
}
```

## src/ifmcu_power.h
```c
/*
 * Copyright (c) 2016-2026 Makerdiary <https://makerdiary.com>
 *
 * SPDX-License-Identifier: Apache-2.0
 */

#ifndef _IFMCU_POWER_H_
#define _IFMCU_POWER_H_

#ifdef __cplusplus
extern "C" {
#endif

/**
 * @brief Turn every LED off and put the nRF52820 into SYSTEM OFF.
 *
 * VBUS detection or the DFU/RST button wakes the chip again, rebooting it
 * with full functionality.  Never returns.
 */
void ifmcu_system_off(void);

#ifdef __cplusplus
}
#endif

#endif /* _IFMCU_POWER_H_ */
```

## src/ifmcu_uart_bridge.c
```c
/*
 * Copyright 2025 Google LLC
 * Copyright (c) 2016-2026 Makerdiary <https://makerdiary.com>
 *
 * SPDX-License-Identifier: Apache-2.0
 */

#include <zephyr/device.h>
#include <zephyr/drivers/uart.h>
#include <zephyr/kernel.h>
#include <zephyr/logging/log.h>
#include <zephyr/sys/ring_buffer.h>
#include <zephyr/drivers/uart/uart_bridge.h>
#include <zephyr/pm/device.h>

#include "led_state.h"

#define DT_DRV_COMPAT zephyr_uart_bridge

LOG_MODULE_REGISTER(uart_bridge, CONFIG_IFMCU_UART_BRIDGE_LOG_LEVEL);

#define RING_BUF_SIZE CONFIG_IFMCU_UART_BRIDGE_BUF_SIZE
#define RING_BUF_FULL_THRESHOLD (RING_BUF_SIZE / 3)

struct uart_bridge_config {
	const struct device *peer_dev[2];
};

struct uart_bridge_peer_data {
	uint8_t buf[RING_BUF_SIZE];
	struct ring_buf rb;
	bool paused;
};

struct uart_bridge_data {
	struct uart_bridge_peer_data peer[2];
};

static const struct device *uart_bridge_get_peer(const struct device *dev,
						 const struct device *bridge_dev)
{
	const struct uart_bridge_config *cfg = bridge_dev->config;

	if (dev == cfg->peer_dev[0]) {
		return cfg->peer_dev[1];
	} else if (dev == cfg->peer_dev[1]) {
		return cfg->peer_dev[0];
	} else {
		return NULL;
	}
}

void uart_bridge_settings_update(const struct device *dev,
				 const struct device *bridge_dev)
{
	struct uart_config cfg;
	const struct device *peer_dev = uart_bridge_get_peer(dev, bridge_dev);
	int ret;

	if (peer_dev == NULL) {
		LOG_DBG("%s: not a bridge dev", dev->name);
		return;
	}

	LOG_DBG("update settings: dev=%s bridge=%s peer=%s", dev->name,
		bridge_dev->name, peer_dev->name);

	ret = uart_config_get(dev, &cfg);
	if (ret) {
		LOG_WRN("%s: failed to get the uart config: %d", dev->name,
			ret);
		return;
	}

	ret = uart_configure(peer_dev, &cfg);
	if (ret) {
		LOG_WRN("%s: failed to set the uart config: %d", peer_dev->name,
			ret);
		return;
	}

	LOG_INF("uart settings: baudrate=%d parity=%d dev=%s",
		cfg.baudrate, cfg.parity, bridge_dev->name);
}

static uint8_t uart_bridge_get_idx(const struct device *dev,
				   const struct device *bridge_dev, bool own)
{
	const struct uart_bridge_config *cfg = bridge_dev->config;

	if (dev == cfg->peer_dev[0]) {
		return own ? 0 : 1;
	} else {
		return own ? 1 : 0;
	}
}

static void uart_bridge_handle_rx(const struct device *dev,
				  const struct device *bridge_dev)
{
	const struct uart_bridge_config *cfg = bridge_dev->config;
	struct uart_bridge_data *data = bridge_dev->data;

	const struct device *peer_dev =
		cfg->peer_dev[uart_bridge_get_idx(dev, bridge_dev, false)];
	struct uart_bridge_peer_data *own_data =
		&data->peer[uart_bridge_get_idx(dev, bridge_dev, true)];

	uint8_t *recv_buf;
	int rb_len, recv_len;
	int ret;

	if (ring_buf_space_get(&own_data->rb) < RING_BUF_FULL_THRESHOLD) {
		LOG_DBG("%s: buffer full: pause", dev->name);
		uart_irq_rx_disable(dev);
		own_data->paused = true;
		return;
	}

	rb_len = ring_buf_put_claim(&own_data->rb, &recv_buf, RING_BUF_SIZE);
	if (rb_len == 0) {
		LOG_WRN("%s: ring_buf full", dev->name);
		return;
	}

	recv_len = uart_fifo_read(dev, recv_buf, rb_len);
	if (recv_len < 0) {
		ring_buf_put_finish(&own_data->rb, 0);
		LOG_ERR("%s: rx error: %d", dev->name, recv_len);
		return;
	}

	ret = ring_buf_put_finish(&own_data->rb, recv_len);
	if (ret < 0) {
		LOG_ERR("%s: ring_buf_put_finish error: %d", dev->name, rb_len);
		return;
	}

	set_uart_led_state(LED_STATE_BLINK);

	uart_irq_tx_enable(peer_dev);
}

static void uart_bridge_handle_tx(const struct device *dev,
				  const struct device *bridge_dev)
{
	const struct uart_bridge_config *cfg = bridge_dev->config;
	struct uart_bridge_data *data = bridge_dev->data;

	const struct device *peer_dev =
		cfg->peer_dev[uart_bridge_get_idx(dev, bridge_dev, false)];
	struct uart_bridge_peer_data *peer_data =
		&data->peer[uart_bridge_get_idx(dev, bridge_dev, false)];

	uint8_t *send_buf;
	int rb_len, sent_len;
	int ret;

	rb_len = ring_buf_get_claim(&peer_data->rb, &send_buf, RING_BUF_SIZE);
	if (rb_len == 0) {
		LOG_DBG("%s: buffer empty, disable tx irq", dev->name);
		uart_irq_tx_disable(dev);
		return;
	}

	sent_len = uart_fifo_fill(dev, send_buf, rb_len);
	if (sent_len < 0) {
		ring_buf_get_finish(&peer_data->rb, 0);
		LOG_ERR("%s: tx error: %d", dev->name, sent_len);
		return;
	}

	ret = ring_buf_get_finish(&peer_data->rb, sent_len);
	if (ret < 0) {
		LOG_ERR("ring_buf_get_finish error: %d", ret);
		return;
	}

	set_uart_led_state(LED_STATE_BLINK);

	if (peer_data->paused &&
	    ring_buf_space_get(&peer_data->rb) > RING_BUF_FULL_THRESHOLD) {
		LOG_DBG("%s: buffer free: resume", dev->name);
		uart_irq_rx_enable(peer_dev);
		peer_data->paused = false;
		return;
	}
}

static void interrupt_handler(const struct device *dev, void *user_data)
{
	const struct device *bridge_dev = user_data;

	while (true) {
		uart_irq_update(dev);

		if (uart_irq_is_pending(dev) <= 0) {
			break;
		}

		if (uart_irq_rx_ready(dev)) {
			uart_bridge_handle_rx(dev, bridge_dev);
		}
		if (uart_irq_tx_ready(dev)) {
			uart_bridge_handle_tx(dev, bridge_dev);
		}
	}
}

static int uart_bridge_pm_action(const struct device *dev,
				 enum pm_device_action action)
{
	const struct uart_bridge_config *cfg = dev->config;

	switch (action) {
	case PM_DEVICE_ACTION_SUSPEND:
		uart_irq_rx_disable(cfg->peer_dev[0]);
		uart_irq_rx_disable(cfg->peer_dev[1]);
		uart_irq_callback_user_data_set(cfg->peer_dev[0], NULL, NULL);
		uart_irq_callback_user_data_set(cfg->peer_dev[1], NULL, NULL);
		break;
	case PM_DEVICE_ACTION_RESUME:
		uart_irq_callback_user_data_set(cfg->peer_dev[0], interrupt_handler,
						(void *)dev);
		uart_irq_callback_user_data_set(cfg->peer_dev[1], interrupt_handler,
						(void *)dev);
		uart_irq_rx_enable(cfg->peer_dev[0]);
		uart_irq_rx_enable(cfg->peer_dev[1]);
		break;
	default:
		return -ENOTSUP;
	}

	return 0;
}

static int uart_bridge_init(const struct device *dev)
{
	struct uart_bridge_data *data = dev->data;

	ring_buf_init(&data->peer[0].rb, RING_BUF_SIZE, data->peer[0].buf);
	ring_buf_init(&data->peer[1].rb, RING_BUF_SIZE, data->peer[1].buf);

	return pm_device_driver_init(dev, uart_bridge_pm_action);
}

#define UART_BRIDGE_INIT(n)							\
	static const struct uart_bridge_config uart_bridge_cfg_##n = {		\
		.peer_dev = {DT_INST_FOREACH_PROP_ELEM_SEP(			\
			n, peers, DEVICE_DT_GET_BY_IDX, (,))},			\
	};									\
										\
	static struct uart_bridge_data uart_bridge_data_##n;			\
										\
	PM_DEVICE_DT_INST_DEFINE(n, uart_bridge_pm_action);			\
										\
	DEVICE_DT_INST_DEFINE(n, uart_bridge_init, PM_DEVICE_DT_INST_GET(n),	\
			      &uart_bridge_data_##n, &uart_bridge_cfg_##n,	\
			      POST_KERNEL, CONFIG_SERIAL_INIT_PRIORITY, NULL);

DT_INST_FOREACH_STATUS_OKAY(UART_BRIDGE_INIT)
```

## src/led_state.c
```c
/*
 * Copyright (c) 2016-2026 Makerdiary <https://makerdiary.com>
 *
 * SPDX-License-Identifier: Apache-2.0
 */

#include <zephyr/device.h>
#include <zephyr/kernel.h>
#include <zephyr/drivers/led.h>
#include "led_state.h"

#include <zephyr/logging/log.h>
LOG_MODULE_REGISTER(led_state, CONFIG_IFMCU_LEDS_LOG_LEVEL);

#define LED_GPIO_NODE_ID		DT_COMPAT_GET_ANY_STATUS_OKAY(gpio_leds)
#define LED_GPIO_NUM			DT_CHILD_NUM(LED_GPIO_NODE_ID)
#define LED_PWM_NODE_ID			DT_COMPAT_GET_ANY_STATUS_OKAY(pwm_leds)
#define LED_PWM_NUM				DT_CHILD_NUM(LED_PWM_NODE_ID)

#define LED_ID_PGOOD_STATE		0	/* Green LED */
#define LED_ID_UART_STATE		1	/* RGB LED - Red */
#define LED_ID_DAP_STATE	    2   /* RGB LED - Blue */

#define LED_ID_CHARGER_STATE	0	/* RGB LED - Green  support SW PWM */

#define LED_STATE_TICK			K_MSEC(50)
#define LED_MAX_BRIGHTNESS		80
#define LED_BREATH_STEP         2

static const struct device *led_gpio = DEVICE_DT_GET(LED_GPIO_NODE_ID);
static const struct device *led_pwm = DEVICE_DT_GET(LED_PWM_NODE_ID);

static bool pgood_led_activity = false;
static bool charger_led_activity = false;
static bool uart_led_activity = false;
static bool dap_led_activity = false;
static led_state_t pgood_led_state = LED_STATE_OFF;
static led_state_t charger_led_state = LED_STATE_OFF;
static led_state_t uart_led_state = LED_STATE_OFF;
static led_state_t dap_led_state = LED_STATE_OFF;

static void led_state_timer_expiry_fn(struct k_timer *timer);
static K_TIMER_DEFINE(led_state_timer, led_state_timer_expiry_fn, NULL);

/* Set VIN Power Good LED state */
void set_pgood_led_state(led_state_t state)
{
    pgood_led_activity = true;
    pgood_led_state = state;
    return;
}

/* Set Charger LED state */
void set_charger_led_state(led_state_t state)
{
    charger_led_activity = true;
    charger_led_state = state;
    return;
}

/* Set DAP LED state */
void set_dap_led_state(led_state_t state)
{
    dap_led_activity = true;
    dap_led_state = state;
    return;
}

/* Set UART LED state */
void set_uart_led_state(led_state_t state)
{
    uart_led_activity = true;
    uart_led_state = state;
    return;
}

void set_all_leds_off(void)
{
	pgood_led_activity = false;
	charger_led_activity = false;
	dap_led_activity = false;
	uart_led_activity = false;

	(void) led_off(led_gpio, LED_ID_PGOOD_STATE);
	(void) led_off(led_pwm, LED_ID_CHARGER_STATE);
	(void) led_off(led_gpio, LED_ID_UART_STATE);
	(void) led_off(led_gpio, LED_ID_DAP_STATE);
}

static void led_state_timer_expiry_fn(struct k_timer *timer)
{
	if (pgood_led_activity) {

		static uint8_t pgood_led_level = 0;

		if (pgood_led_state == LED_STATE_ON) {

			pgood_led_level = LED_MAX_BRIGHTNESS;

		} else if ((pgood_led_state == LED_STATE_BLINK) || (pgood_led_state == LED_STATE_BLINK_PERMANENT)) {
			// Toggle LED level
			pgood_led_level = pgood_led_level > 0 ? 0 : LED_MAX_BRIGHTNESS;

			// If in blink mode stop after one cycle
			if ((pgood_led_level == 0) && (pgood_led_state == LED_STATE_BLINK)) {
				pgood_led_activity = false;
				pgood_led_state = LED_STATE_OFF;
			}
		} else {
			// LED next state is LED_STATE_OFF
			pgood_led_level = 0;
			pgood_led_activity = false;
		}

		// update LED
		(void) led_set_brightness(led_gpio, LED_ID_PGOOD_STATE, pgood_led_level);
	}

	if (charger_led_activity) {

		static uint8_t charger_led_level = 0;

		if (charger_led_state == LED_STATE_ON) {

			charger_led_level = LED_MAX_BRIGHTNESS;

		}else if ((charger_led_state == LED_STATE_BLINK) || (charger_led_state == LED_STATE_BLINK_PERMANENT)) {
			// Toggle LED level
			charger_led_level = charger_led_level > 0 ? 0 : LED_MAX_BRIGHTNESS;

			// If in blink mode stop after one cycle
			if ((charger_led_level == 0) && (charger_led_state == LED_STATE_BLINK)) {
				charger_led_activity = false;
				charger_led_state = LED_STATE_OFF;
			}
		} else if (charger_led_state == LED_STATE_BREATH) {

			static uint8_t charger_led_dir = 1U;

			if (charger_led_dir) {
				charger_led_level += LED_BREATH_STEP;
				if (charger_led_level > LED_MAX_BRIGHTNESS) {
					charger_led_level -= LED_BREATH_STEP;
					charger_led_dir = 0U;
				}
			} else {
				if (charger_led_level > LED_BREATH_STEP) {
					charger_led_level -= LED_BREATH_STEP;
				} else {
					charger_led_level = 0;
					charger_led_dir = 1U;
				}
			}
		} else {
			// LED next state is LED_STATE_OFF
			charger_led_level = 0;
			charger_led_activity = false;
		}

		// update LED
		(void) led_set_brightness(led_pwm, LED_ID_CHARGER_STATE, charger_led_level);
	}

	if (uart_led_activity) {

		static uint8_t uart_led_level = 0;

		if (uart_led_state == LED_STATE_ON) {
			uart_led_level = LED_MAX_BRIGHTNESS;
		} else if ((uart_led_state == LED_STATE_BLINK) || (uart_led_state == LED_STATE_BLINK_PERMANENT)) {
			// Toggle LED level
			uart_led_level = uart_led_level > 0 ? 0 : LED_MAX_BRIGHTNESS;

			// If in blink mode stop after one cycle
			if ((uart_led_level == 0) && (uart_led_state == LED_STATE_BLINK)) {
				uart_led_activity = false;
				uart_led_state = LED_STATE_OFF;
			}
		} else {
			// LED next state is LED_STATE_OFF
			uart_led_level = 0;
			uart_led_activity = false;
		}

		// update LED
		(void) led_set_brightness(led_gpio, LED_ID_UART_STATE, uart_led_level);
	}

	if (dap_led_activity) {

		static uint8_t dap_led_level = 0;

		if ((dap_led_state == LED_STATE_BLINK) || (dap_led_state == LED_STATE_BLINK_PERMANENT)) {
			// Toggle LED level
			dap_led_level = dap_led_level > 0 ? 0 : LED_MAX_BRIGHTNESS;

			// If in blink mode stop after one cycle
			if ((dap_led_level == 0) && (dap_led_state == LED_STATE_BLINK)) {
				dap_led_activity = false;
				dap_led_state = LED_STATE_OFF;
			}
		} else {
			// LED next state is LED_STATE_OFF
			dap_led_level = 0;
			dap_led_activity = false;
		}

		// update LED
		(void) led_set_brightness(led_gpio, LED_ID_DAP_STATE, dap_led_level);
	}
}

int led_state_init(void)
{
	k_timer_start(&led_state_timer, LED_STATE_TICK, LED_STATE_TICK);
	return 0;
}
```

## src/led_state.h
```c
/*
 * Copyright (c) 2016-2026 Makerdiary <https://makerdiary.com>
 *
 * SPDX-License-Identifier: Apache-2.0
 */

#ifndef _LED_STATE_H_
#define _LED_STATE_H_

/**
 * @file
 * @defgroup led_state LED state
 * @{
 * @brief LED state.
 */

#ifdef __cplusplus
extern "C" {
#endif

/** @brief led states in the application. */
typedef enum led_state {
    LED_STATE_OFF = 0,
    LED_STATE_ON,
    LED_STATE_BLINK,
	LED_STATE_BLINK_PERMANENT,
    LED_STATE_BREATH,
    LED_STATE_COUNT
} led_state_t;

int led_state_init(void);
void set_pgood_led_state(led_state_t state);
void set_charger_led_state(led_state_t state);
void set_uart_led_state(led_state_t state);
void set_dap_led_state(led_state_t state);
void set_all_leds_off(void);

#ifdef __cplusplus
}
#endif

/**
 * @}
 */

#endif /* _LED_STATE_H_ */
```
