## applications/ifmcu_firmware/src/events/Kconfig
```kconfig
#
# Copyright (c) 2020 Nordic Semiconductor
# Copyright (c) 2016-2025 Makerdiary <https://makerdiary.com>
#
# SPDX-License-Identifier: LicenseRef-Nordic-5-Clause
#

if LOG

menu "Event options"

comment "Initially logged events"

config IFMCU_LOG_MODULE_STATE_EVENT
	bool "Module state event"
	default y

config IFMCU_LOG_UART_DATA_EVENT
	bool "UART data event"
	default y

config IFMCU_LOG_CDC_DATA_EVENT
	bool "CDC data event"
	default y

config IFMCU_LOG_PEER_CONN_EVENT
	bool "Peer connection event"
	default y

config IFMCU_LOG_POWER_DOWN_EVENT
	bool "Power down event"
	default y

endmenu

endif
```

## applications/ifmcu_firmware/src/modules/Kconfig
```kconfig
#
# Copyright (c) 2020 Nordic Semiconductor
# Copyright (c) 2016-2025 Makerdiary <https://makerdiary.com>
#
# SPDX-License-Identifier: LicenseRef-Nordic-5-Clause
#

module = IFMCU_UART
module-str = UART device
source "subsys/logging/Kconfig.template.log_config"

config IFMCU_CDC_ENABLE
	bool "Enable USB CDC ACM"
	depends on USB_DEVICE_STACK
	select USB_CDC_ACM
	help
		This option enables USB CDC ACM
		and exposes a COM port, bridging the UART0 interface.

if IFMCU_CDC_ENABLE

module = IFMCU_CDC
module-str = USB CDC ACM device
source "subsys/logging/Kconfig.template.log_config"

endif

config IFMCU_CMSIS_DAP_BULK_ENABLE
	bool "Enable USB Bulk"
	depends on USB_DEVICE_STACK
	select USB_DEVICE_BOS

config IFMCU_CMSIS_DAP_VENDOR_COMMANDS
	bool "Enable vendor specific commands"
	depends on IFMCU_CMSIS_DAP_BULK_ENABLE
	help
	  This option enables vendor specific commands for CMSIS-DAP Bulk.
	  Currently, these are only relevant for the nRF9151 Connect Kit board.

if IFMCU_CMSIS_DAP_BULK_ENABLE

module = IFMCU_BULK
module-str = USB Bulk device
source "subsys/logging/Kconfig.template.log_config"

config BULK_USB_THREAD_STACK_SIZE
	int "USB Bulk thread stack size"
	default 1024
	help
	  Size of stack for USB Bulk handler thread.

endif

if PM_DEVICE

module = IFMCU_POWER_MGMT
module-str = Interface MCU power management
source "subsys/logging/Kconfig.template.log_config"

endif

config IFMCU_BUF_SIZE
	int "Transport interface buffer size"
	default 512
	help
	  Size of transmit/receive buffer for transfer between interfaces.

config IFMCU_UART_BUF_COUNT
	int "UART buffer block count"
	default 3
	range 3 255
	help
	  Number of buffer blocks assigned for UART instances.
	  This value is scaled with the number of interfaces.
	  With the default instance count of 1, and for example 3 buffers,
	  the total will be 3 buffers.
	  Note that all buffers are shared between UART instances.

if LED

module = IFMCU_LEDS
module-str = Interface MCU leds
source "subsys/logging/Kconfig.template.log_config"

endif # LED

if CHARGER

module = IFMCU_CHARGER
module-str = Interface MCU charger
source "subsys/logging/Kconfig.template.log_config"

endif # CHARGER

if SETTINGS

module = IFMCU_SETTINGS
module-str = Interface MCU settings
source "subsys/logging/Kconfig.template.log_config"

endif # SETTINGS

config IFMCU_UTILS_ENABLE
	bool "Enable utils module"
	select SENSOR
	help
		This option enables utils modules.

if IFMCU_UTILS_ENABLE

module = IFMCU_UTILS
module-str = Utils module
source "subsys/logging/Kconfig.template.log_config"

endif # IFMCU_UTILS_ENABLE
```

## applications/serial_lte_modem/sample.yaml
```yaml
sample:
  name: Serial LTE Modem
tests:
  applications.serial_lte_modem:
    sysbuild: true
    build_only: true
    integration_platforms:
      - nrf9151_connectkit/nrf9151/ns
  applications.serial_lte_modem.native_tls:
    sysbuild: true
    build_only: true
    extra_args: EXTRA_CONF_FILE=overlay-native_tls.conf
    integration_platforms:
      - nrf9151_connectkit/nrf9151/ns
  applications.serial_lte_modem.lwm2m_carrier:
    sysbuild: true
    build_only: true
    extra_args: EXTRA_CONF_FILE=overlay-carrier.conf
    integration_platforms:
      - nrf9151_connectkit/nrf9151/ns
  applications.serial_lte_modem.lwm2m_carrier.softbank:
    sysbuild: true
    build_only: true
    extra_args: EXTRA_CONF_FILE="overlay-carrier.conf;overlay-carrier-softbank.conf"
      SB_EXTRA_CONF_FILE=sysbuild-softbank.conf
    integration_platforms:
      - nrf9151_connectkit/nrf9151/ns
  applications.serial_lte_modem.lwm2m_carrier.lgu:
    sysbuild: true
    build_only: true
    extra_args: EXTRA_CONF_FILE="overlay-carrier.conf;overlay-carrier-lgu.conf"
    integration_platforms:
      - nrf9151_connectkit/nrf9151/ns
```

## boards/makerdiary/nrf9151_connectkit/Kconfig.nrf9151_connectkit
```kconfig
# nRF9151 Connect Kit board configuration

# Copyright (c) 2016-2025 Makerdiary <https://makerdiary.com>
# SPDX-License-Identifier: Apache-2.0

config BOARD_NRF9151_CONNECTKIT
	select SOC_NRF52820_QDAA if BOARD_NRF9151_CONNECTKIT_NRF52820
	select SOC_NRF9151_LACA if BOARD_NRF9151_CONNECTKIT_NRF9151 || BOARD_NRF9151_CONNECTKIT_NRF9151_NS
```

## boards/makerdiary/nrf9151_connectkit/nrf9151_connectkit_nrf52820_defconfig
```kconfig
#
# Copyright (c) 2016-2025 Makerdiary <https://makerdiary.com>
#
# SPDX-License-Identifier: Apache-2.0
#

# Enable MPU
CONFIG_ARM_MPU=y

# enable GPIO
CONFIG_GPIO=y

# enable PWM
CONFIG_PWM=y

# enable I2C
CONFIG_I2C=y

# enable charger
CONFIG_CHARGER=y

# enable LED(both LED_GPIO and LED_PWM)
CONFIG_LED=y

# Support UF2 Bootloader
CONFIG_USE_DT_CODE_PARTITION=y
CONFIG_BUILD_OUTPUT_UF2=y
CONFIG_BUILD_OUTPUT_UF2_FAMILY_ID="0x820D9A5F"
```

## samples/adc/sample.yaml
```yaml
sample:
  name: ADC devicetree driver sample
tests:
  sample.adc:
    sysbuild: true
    build_only: true
    integration_platforms:
      - nrf9151_connectkit/nrf9151
      - nrf9151_connectkit/nrf9151/ns
```

## samples/at_monitor/sample.yaml
```yaml
sample:
  name: AT monitor sample
tests:
  sample.at_monitor:
    sysbuild: true
    build_only: true
    integration_platforms:
      - nrf9151_connectkit/nrf9151/ns
```

## samples/button/sample.yaml
```yaml
sample:
  name: Button sample
tests:
  sample.button:
    sysbuild: true
    build_only: true
    integration_platforms:
      - nrf9151_connectkit/nrf9151
      - nrf9151_connectkit/nrf9151/ns
```

## samples/gnss/sample.yaml
```yaml
sample:
  name: GNSS sample
tests:
  sample.gnss:
    sysbuild: true
    build_only: true
    integration_platforms:
      - nrf9151_connectkit/nrf9151/ns
```

## samples/mqtt/sample.yaml
```yaml
sample:
  name: mqtt
tests:
  sample.mqtt:
    sysbuild: true
    build_only: true
    integration_platforms:
      - nrf9151_connectkit/nrf9151/ns
  sample.mqtt.nrf91.tls:
    sysbuild: true
    build_only: true
    integration_platforms:
      - nrf9151_connectkit/nrf9151/ns
    extra_args: EXTRA_CONF_FILE=overlay-tls-nrf91.conf
```

## samples/nrf_cloud_multi_service/sample.yaml
```yaml
sample:
  name: nRF Cloud Multi Service Sample
tests:
  sample.nrf_cloud_multi_service.mqtt:
    sysbuild: true
    build_only: true
    integration_platforms:
      - nrf9151_connectkit/nrf9151/ns
    extra_args: EXTRA_CONF_FILE="overlay-http_nrf_provisioning.conf"
  sample.nrf_cloud_multi_service.mqtt.min:
    sysbuild: true
    build_only: true
    integration_platforms:
      - nrf9151_connectkit/nrf9151/ns
    extra_args: EXTRA_CONF_FILE="overlay_min_mqtt.conf"
  sample.nrf_cloud_multi_service.coap:
    sysbuild: true
    build_only: true
    integration_platforms:
      - nrf9151_connectkit/nrf9151/ns
    extra_args: EXTRA_CONF_FILE="overlay_coap.conf"
  sample.nrf_cloud_multi_service.coap.min:
    sysbuild: true
    build_only: true
    integration_platforms:
      - nrf9151_connectkit/nrf9151/ns
    extra_args: EXTRA_CONF_FILE="overlay_coap.conf;overlay_min_coap.conf"
  sample.nrf_cloud_multi_service.coap.trace:
    sysbuild: true
    build_only: true
    integration_platforms:
      - nrf9151_connectkit/nrf9151/ns
    extra_args: EXTRA_CONF_FILE="overlay-coap_nrf_provisioning.conf;overlay_coap.conf"
      nrf_cloud_multi_service_SNIPPET=nrf91-modem-trace-rtt
```

## samples/nrf_provisioning/sample.yaml
```yaml
sample:
  name: nRF Device Provisioning
tests:
  sample.nrf_provisioning:
    sysbuild: true
    build_only: true
    integration_platforms:
      - nrf9151_connectkit/nrf9151/ns
```
