## Kconfig
```
#
# Copyright (c) 2020 Nordic Semiconductor ASA
#
# SPDX-License-Identifier: LicenseRef-Nordic-5-Clause
#

menu "Nordic Modem Shell config"

config MOSH_IPERF3
	bool "iPerf3"
	default y
	select NRF_IPERF3

config NRF_IPERF3_PROMPTLESS
	bool
	default y

config MOSH_SOCK
	bool "Socket tool"
	default y
	help
	  Socket tool with TCP, UDP, RAW, IPv4, IPv6 and packet socket support.

config MOSH_PING
	bool "ICMP ping"
	default y
	help
	  Ping is a tool for testing the reachability of a host on an IP network.

config MOSH_CURL
	bool "cURL"
	default y
	select NRF_CURL

config NRF_CURL_PROMPTLESS
	bool
	default y

config MOSH_GNSS
	bool "GNSS"
	default y
	help
	  GNSS feature for searching the location of the device.

config MOSH_PPP
	bool "PPP"
	help
	  Point-to-Point Protocol for enabling dial-up access to the Internet.

config MOSH_SMS
	bool "SMS"
	default y
	help
	  SMS tool for sending and receiving SMS messages.

config MOSH_LOCATION
	bool "Location"
	default y
	select LOCATION
	select NRF_CLOUD_LOCATION if MOSH_CLOUD_MQTT && (LOCATION_METHOD_CELLULAR || LOCATION_METHOD_WIFI)
	help
	  Tool for location queries via location library.

config MOSH_FOTA
	bool "FOTA"
	default y
	help
	  FOTA for performing software updates over-the-air for both modem and application side.

config MOSH_REST
	bool "REST client"
	default y
	select REST_CLIENT
	help
	  REST client for sending and receiving simple REST requests/responses.

config MOSH_CLOUD_MQTT
	bool "MQTT connection to nRF Cloud"
	select NRF_CLOUD_MQTT
	help
	  MQTT connection to nRF Cloud.

config MOSH_CLOUD_COAP
	bool "CoAP connection to nRF Cloud"
	select NRF_CLOUD_COAP
	select MODEM_JWT
	help
	  CoAP connection to nRF Cloud.

config MOSH_CLOUD_LWM2M
	bool "Cloud connection using LwM2M"
	help
	  Cloud connection using LwM2M.

config MOSH_AT_CMD_MODE
	bool "Specific AT command mode"
	default y

config MOSH_GPIO_COUNT
	bool "GPIO pin pulse counter"
	default y if !BOARD_THINGY91_NRF9160_NS
	help
	  Tool for counting the number of pulses on a GPIO pin.

config MOSH_NTN
	bool "Non-Terrestrial Network (NTN)"
	default y
	select NTN
	help
	  Helper functionality for NTN usage.

config SAMPLE_MOSH_IRONSIDE_SE_EVENT_REPORT
	bool "IronSide SE event report monitoring"
	default y if SOC_NRF9251_CPUAPP
	depends on HAS_IRONSIDE_SE_CALL
	help
	  Subscribe to IronSide SE event report bells (1 and 2) and print
	  received event reports to the terminal.

config MOSH_PRINT_BUFFER_SIZE
	int "Buffer size used when printing modem shell output"
	default 1024
	help
	  If the printed string exceeds this buffer, an error message is printed first and
	  then the requested string cut into the length of this buffer.

config MOSH_COMMON_WORKQUEUE_STACK_SIZE
	int "Common workqueue stack size"
	default 7168 if MOSH_CLOUD_MQTT
	default 6144 if MOSH_STARTUP_CMDS && MOSH_CURL
	default 4096

config MOSH_COMMON_WORKQUEUE_PRIORITY
	int "Common workqueue priority"
	default 5

if NRF_IPERF3

config NRF_IPERF3_RESULTS_WAIT_TIME
	default 180
endif

if MOSH_IPERF3 || MOSH_PING
menu "MoSH iperf3 and ping command selections"

config MOSH_WORKER_THREADS
	bool "Possibility to run iperf3 or ping instances in separate threads"
	default y

config MOSH_STARTUP_CMDS
	bool "Possibility to run stored MoSh commands from settings after bootup"
	default y

config MOSH_NRF91_NON_OFFLOADING_DEV
	bool "Possibility to run iperf3 with Zephyr TCP/IP stack"

endmenu
endif

if MOSH_AT_CMD_MODE
choice
	prompt "Command termination"
	default MOSH_AT_CMD_MODE_CR_LF_TERMINATION
	help
	  Sets the command termination ending from the serial terminal
	  Levels are:
	  -  NULL Termination
	  -  CR Termination
	  -  LF Termination
	  -  CR+LF Termination

config MOSH_AT_CMD_MODE_NULL_TERMINATION
	bool "NULL Termination"

config MOSH_AT_CMD_MODE_CR_TERMINATION
	bool "CR Termination"

config MOSH_AT_CMD_MODE_LF_TERMINATION
	bool "LF Termination"

config MOSH_AT_CMD_MODE_CR_LF_TERMINATION
	bool "CR+LF Termination"

endchoice

config MOSH_AT_CMD_MODE_TERMINATION
	int
	default 0 if MOSH_AT_CMD_MODE_NULL_TERMINATION
	default 1 if MOSH_AT_CMD_MODE_CR_TERMINATION
	default 2 if MOSH_AT_CMD_MODE_LF_TERMINATION
	default 3 if MOSH_AT_CMD_MODE_CR_LF_TERMINATION
endif

menu "MoSH link control selections"

config MOSH_LINK_SETT_NORMAL_MODE_AT_CMD_STR_LEN
	int "Link settings AT command length"
	default 127
	help
	  String length for custom AT commands stored into settings to be used
	  when going to normal mode.

endmenu

if MOSH_WORKER_THREADS

config MOSH_WORKER_THREADS_OUTPUT_BUFFER_SIZE
	int "Buffer size for storing output of the background thread commands"
	default 4096

config MOSH_WORKER_THREADS_STACK_SIZE
	int "Worker thread stack size"
	default 4096

endif #MOSH_WORKER_THREADS

if MOSH_CLOUD_LWM2M

config MOSH_LWM2M_PSK
	string "LwM2M pre-shared key for communication"
	help
	  Pre-shared key must be identical to the PSK registered with the device on the LwM2M server.
	  Use the hexadecimal representation.

config MOSH_LWM2M_ENDPOINT_PREFIX
	string "Prefix used in the LwM2M endpoint name"
	default "urn:imei:"
	help
	  Sets the prefix of the endpoint name used when connecting to the LwM2M server.

# Make AVSystem the default LwM2M server.
config LWM2M_CLIENT_UTILS_SERVER
	string "LwM2M server address"
	default "coaps://eu.iot.avsystem.cloud:5684"
	help
	  Kconfig redefinition, please see the help text of the original definition.

endif # MOSH_CLOUD_LWM2M

# For power measurement purposes, activate low power mode for asynchronous UARTs.
if UART_0_ASYNC

config UART_0_NRF_ASYNC_LOW_POWER
	bool "Low power mode"
	default y

endif # UART_0_ASYNC

if UART_1_ASYNC

config UART_1_NRF_ASYNC_LOW_POWER
	bool "Low power mode"
	default y

endif # UART_1_ASYNC

endmenu # Modem Shell

menu "Zephyr Kernel"
source "Kconfig.zephyr"
endmenu
```

## sample.yaml
```
sample:
  name: Modem Shell
tests:
  applications.modem_shell:
    sysbuild: true
    build_only: true
    integration_platforms:
      - nrf9151_connectkit/nrf9151/ns
```

## prj.conf
```kconfig
#
# Copyright (c) 2020 Nordic Semiconductor ASA
#
# SPDX-License-Identifier: LicenseRef-Nordic-5-Clause
#
# General config

CONFIG_MOSH_IPERF3=y
CONFIG_MOSH_SOCK=y
CONFIG_MOSH_PING=y
CONFIG_MOSH_CURL=y
CONFIG_MOSH_SMS=y
CONFIG_MOSH_GNSS=y
CONFIG_MOSH_LOCATION=y

# Stacks and heaps
CONFIG_MAIN_STACK_SIZE=4096
CONFIG_HEAP_MEM_POOL_SIZE=8192

# System queue is used e.g. by AT monitor and SMS lib
CONFIG_SYSTEM_WORKQUEUE_STACK_SIZE=2048

# Shell configurations
CONFIG_SHELL=y
CONFIG_SHELL_WILDCARD=n
CONFIG_SHELL_PROMPT_UART="mosh:~$ "
CONFIG_SHELL_ARGC_MAX=40
# -h and --help options are handled in Modem Shell
CONFIG_SHELL_HELP_OPT_PARSE=n
# Command line buffer is set this large to enable writing of certificates and injecting A-GNSS data on command line.
CONFIG_SHELL_CMD_BUFF_SIZE=3584
# Shell stack has impact for modem shell application, not CONFIG_MAIN_STACK_SIZE
CONFIG_SHELL_STACK_SIZE=9216
# Shell RX buffer needs to be increased to avoid problems with test automation
CONFIG_SHELL_BACKEND_SERIAL_RX_RING_BUFFER_SIZE=512
# Use interrupt driven shell UART, otherwise we won't be able to suspend the UART
CONFIG_SHELL_BACKEND_SERIAL_API_INTERRUPT_DRIVEN=y
# LTE shell is unnecessary with Modem Shell
CONFIG_LTE_SHELL=n
# Enable use of vsnprintfcb() for extending mosh_print() format
CONFIG_CBPRINTF_LIBC_SUBSTS=y

CONFIG_MINIMAL_LIBC=n
CONFIG_NEWLIB_LIBC=y
CONFIG_NEWLIB_LIBC_FLOAT_SCANF=y
CONFIG_NEWLIB_LIBC_FLOAT_PRINTF=y
CONFIG_FPU=y
CONFIG_CJSON_LIB=y

# Getopt
CONFIG_GETOPT_LIB=y
# Need to disable devmem shell since it enforces Zephyr's internal version of getopt
CONFIG_DEVMEM_SHELL=n

# Device power management
CONFIG_PM_DEVICE=y

# Needed for changing the UART baudrate at runtime
CONFIG_UART_USE_RUNTIME_CONFIGURE=y

# Modem info
CONFIG_MODEM_INFO=y

# Modem key management
CONFIG_MODEM_KEY_MGMT=y

# Network
CONFIG_NETWORKING=y
CONFIG_NET_NATIVE=n
CONFIG_NET_SOCKETS=y
CONFIG_NET_SOCKETS_OFFLOAD=y
CONFIG_NET_SOCKETS_POSIX_NAMES=n
CONFIG_NET_IPV4=y
CONFIG_NET_IPV6=y

CONFIG_POSIX_API=y
CONFIG_PTHREAD_IPC=n # There are issues with posix api if this is set
CONFIG_ZVFS_OPEN_MAX=10
# Need to be the same as MAX_FDS
CONFIG_NET_SOCKETS_POLL_MAX=10

# Modem library
CONFIG_NRF_MODEM_LIB=y
CONFIG_NRF_MODEM_LIB_SHMEM_TX_SIZE=22528
CONFIG_NRF_MODEM_LIB_SHMEM_RX_SIZE=8192
CONFIG_NRF_MODEM_LIB_ON_FAULT_APPLICATION_SPECIFIC=y

# AT monitor library
CONFIG_AT_MONITOR=y

# Increase AT monitor heap because %NCELLMEAS notifications can be long.
# Note: with legacy NCELLMEAS types, 512 is enough, but with GCI search types
# it could be even longer: theoretical maximum of 4020 bytes.
CONFIG_AT_MONITOR_HEAP_SIZE=1024

# Custom AT commands
CONFIG_AT_CMD_CUSTOM=y
CONFIG_AT_CMD_CUSTOM_LOG_LEVEL_OFF=y

# PDN library
CONFIG_PDN=y
CONFIG_PDN_ESM_STRERROR=y

# SMS
CONFIG_SMS=y

# LTE link control
CONFIG_LTE_LINK_CONTROL=y
# Use modem system mode setting by default
CONFIG_LTE_NETWORK_MODE_DEFAULT=y
# These can be enabled at runtime using shell commands
CONFIG_LTE_LC_MODEM_SLEEP_NOTIFICATIONS=n
CONFIG_LTE_LC_TAU_PRE_WARNING_NOTIFICATIONS=n
# Minimum values for thresholds
CONFIG_LTE_LC_TAU_PRE_WARNING_THRESHOLD_MS=10240
CONFIG_LTE_LC_MODEM_SLEEP_NOTIFICATIONS_THRESHOLD_MS=10240
# Maximum number of neighbor cells for neighbor cell measurement
CONFIG_LTE_NEIGHBOR_CELLS_MAX=17
# Enable required modules
CONFIG_LTE_LC_CONN_EVAL_MODULE=y
CONFIG_LTE_LC_EDRX_MODULE=y
CONFIG_LTE_LC_NEIGHBOR_CELL_MEAS_MODULE=y
CONFIG_LTE_LC_PERIODIC_SEARCH_MODULE=y
CONFIG_LTE_LC_PSM_MODULE=y
CONFIG_LTE_LC_RAI_MODULE=y
CONFIG_LTE_LC_MODEM_SLEEP_MODULE=y
CONFIG_LTE_LC_TAU_PRE_WARNING_MODULE=y

CONFIG_DATE_TIME=y

# nRF Cloud A-GNSS, disable this in case you want to enable SUPL below
CONFIG_NRF_CLOUD_AGNSS=y

# SUPL A-GNSS support, needs the nRF9160 SiP SUPL client library from nRF9160 DK product page
#CONFIG_SUPL_CLIENT_LIB=y

# Library for buttons and LEDs
# We don't have any LEDs for indicating so just disable it by default.
CONFIG_DK_LIBRARY=n

# FOTA
CONFIG_FLASH=y
CONFIG_REBOOT=y
CONFIG_DFU_TARGET=y
CONFIG_FOTA_DOWNLOAD=y
CONFIG_DOWNLOADER=y
CONFIG_DOWNLOADER_SHELL=y
# BOOTLOADER_MCUBOOT reduces usable flash size by half so it's disabled by default
# This means application FOTA is disabled. Modem FOTA works without these.
CONFIG_BOOTLOADER_MCUBOOT=n
CONFIG_IMG_MANAGER=n
CONFIG_IMG_ERASE_PROGRESSIVELY=n

# Settings
CONFIG_FLASH=y
CONFIG_FLASH_MAP=y
CONFIG_MPU_ALLOW_FLASH_WRITE=y
CONFIG_NVS=y
CONFIG_SETTINGS=y
CONFIG_SETTINGS_NVS=y
CONFIG_NVS_LOG_LEVEL_WRN=y

# Debugging configurations
CONFIG_ASSERT=y
CONFIG_LOG=y
# Keep printk() synchronous
CONFIG_LOG_PRINTK=n
CONFIG_DEBUG_INFO=y
#CONFIG_DEBUG_OPTIMIZATIONS=y
#CONFIG_NO_OPTIMIZATIONS=y
#CONFIG_FORCE_NO_ASSERT=y
CONFIG_ASSERT_VERBOSE=y
#CONFIG_ASSERT_LEVEL=2
#CONFIG_ASSERT_ON_ERRORS=y
#CONFIG_FAULT_DUMP=2
CONFIG_RESET_ON_FATAL_ERROR=n
CONFIG_EXTRA_EXCEPTION_INFO=y
#CONFIG_WATCHDOG=y
CONFIG_SYS_HEAP_RUNTIME_STATS=y
# Enable TF-M logging on UART0
CONFIG_TFM_SECURE_UART0=y
CONFIG_TFM_LOG_LEVEL_SILENCE=n
CONFIG_TFM_EXCEPTION_INFO_DUMP=y
CONFIG_TFM_SPM_LOG_LEVEL_DEBUG=y
```

## ppp.overlay
```dts
/*
 * Copyright (c) 2021 Nordic Semiconductor ASA
 *
 * SPDX-License-Identifier: LicenseRef-Nordic-5-Clause
 */

/ {
	chosen {
		zephyr,ppp-uart = &uart0;
	};
};
```

## src/main.c
```c
/*
 * Copyright (c) 2020 Nordic Semiconductor ASA
 *
 * SPDX-License-Identifier: LicenseRef-Nordic-5-Clause
 */

#include <stdio.h>
#include <string.h>
#include <sys/types.h>

#include <zephyr/kernel.h>
#include <zephyr/init.h>
#include <zephyr/logging/log_ctrl.h>
#include <zephyr/sys/reboot.h>
#include <zephyr/dfu/mcuboot.h>
#include <zephyr/shell/shell.h>
#if defined(CONFIG_SHELL_BACKEND_SERIAL)
#include <zephyr/shell/shell_uart.h>
#else
#include <zephyr/shell/shell_rtt.h>
#endif

#include <nrf_modem.h>
#include <helpers/nrfx_reset_reason.h>
#include <modem/nrf_modem_lib.h>
#include <modem/nrf_modem_lib_trace.h>
#include <modem/modem_info.h>
#include <modem/lte_lc.h>
#include <net/nrf_cloud_os.h>
#include <dk_buttons_and_leds.h>

#include "mosh_defines.h"
#include "mosh_print.h"
#include "link.h"
#include "uart_shell.h"

#if defined(CONFIG_MOSH_PPP)
#include "ppp_ctrl.h"
#endif

#if defined(CONFIG_MOSH_GNSS)
#include "gnss.h"
#endif

#if defined(CONFIG_MOSH_FOTA)
#include "fota.h"
#endif
#if defined(CONFIG_MOSH_WORKER_THREADS)
#include "th_ctrl.h"
#endif

#if defined(CONFIG_MOSH_LOCATION)
#include "location_shell.h"
#endif

#if defined(CONFIG_MOSH_STARTUP_CMDS)
#include "startup_cmd_ctrl.h"
#endif

#if defined(CONFIG_MOSH_AT_CMD_MODE)
#include "at_cmd_mode.h"
#include "at_cmd_mode_sett.h"
#endif

BUILD_ASSERT(IS_ENABLED(CONFIG_SHELL_BACKEND_SERIAL) || IS_ENABLED(CONFIG_SHELL_BACKEND_RTT),
	     "CONFIG_SHELL_BACKEND_SERIAL or CONFIG_SHELL_BACKEND_RTT shell backend must be "
	     "enabled");

/***** Work queue and work item definitions *****/

#define MOSH_COMMON_WORKQ_PRIORITY CONFIG_MOSH_COMMON_WORKQUEUE_PRIORITY
K_THREAD_STACK_DEFINE(mosh_common_workq_stack, CONFIG_MOSH_COMMON_WORKQUEUE_STACK_SIZE);
struct k_work_q mosh_common_work_q;

/* Global variables */
const struct shell *mosh_shell;
struct k_poll_signal mosh_signal;

char mosh_at_resp_buf[MOSH_AT_CMD_RESPONSE_MAX_LEN];
K_MUTEX_DEFINE(mosh_at_resp_buf_mutex);

static const char *modem_crash_reason_get(uint32_t reason)
{
	switch (reason) {
	case NRF_MODEM_FAULT_UNDEFINED:
		return "Undefined fault";

	case NRF_MODEM_FAULT_HW_WD_RESET:
		return "HW WD reset";

	case NRF_MODEM_FAULT_HARDFAULT:
		return "Hard fault";

	case NRF_MODEM_FAULT_MEM_MANAGE:
		return "Memory management fault";

	case NRF_MODEM_FAULT_BUS:
		return "Bus fault";

	case NRF_MODEM_FAULT_USAGE:
		return "Usage fault";

	case NRF_MODEM_FAULT_SECURE_RESET:
		return "Secure control reset";

	case NRF_MODEM_FAULT_PANIC_DOUBLE:
		return "Error handler crash";

	case NRF_MODEM_FAULT_PANIC_RESET_LOOP:
		return "Reset loop";

	case NRF_MODEM_FAULT_ASSERT:
		return "Assert";

	case NRF_MODEM_FAULT_PANIC:
		return "Unconditional SW reset";

	case NRF_MODEM_FAULT_FLASH_ERASE:
		return "Flash erase fault";

	case NRF_MODEM_FAULT_FLASH_WRITE:
		return "Flash write fault";

	case NRF_MODEM_FAULT_POFWARN:
		return "Undervoltage fault";

	case NRF_MODEM_FAULT_THWARN:
		return "Overtemperature fault";

	default:
		return "Unknown reason";
	}
}

static void modem_crash_work_fn(struct k_work *work)
{
	mosh_error("Modem crash detected, halting application execution");

#if defined(CONFIG_NRF_MODEM_LIB_TRACE)
	nrf_modem_lib_trace_processing_done_wait(K_SECONDS(5));
#endif

	k_oops();
}

K_WORK_DEFINE(modem_crash_work, modem_crash_work_fn);

void nrf_modem_fault_handler(struct nrf_modem_fault_info *fault_info)
{
	printk("Modem crash reason: 0x%x (%s), PC: 0x%x\n",
		fault_info->reason,
		modem_crash_reason_get(fault_info->reason),
		fault_info->program_counter);

	k_work_submit(&modem_crash_work);
}

#if defined(CONFIG_NRF_MODEM_LIB_SHELL_TRACE)
void nrf_modem_lib_trace_callback(enum nrf_modem_lib_trace_event evt)
{
	if (evt == NRF_MODEM_LIB_TRACE_EVT_FULL) {
		mosh_warn("Modem trace storage is full.");
		mosh_print("It is recommended to stop modem tracing before sending.");
		mosh_print("Send or clear modem traces before re-starting.");
	}
}
#endif

static void reset_reason_str_get(char *str, uint32_t reason)
{
	size_t len;

	*str = '\0';

	if (reason & NRFX_RESET_REASON_RESETPIN_MASK) {
		(void)strcat(str, "PIN reset | ");
	}
	if (reason & NRFX_RESET_REASON_DOG_MASK) {
		(void)strcat(str, "watchdog | ");
	}
	if (reason & NRFX_RESET_REASON_OFF_MASK) {
		(void)strcat(str, "wakeup from power-off | ");
	}
	if (reason & NRFX_RESET_REASON_DIF_MASK) {
		(void)strcat(str, "debug interface wakeup | ");
	}
	if (reason & NRFX_RESET_REASON_SREQ_MASK) {
		(void)strcat(str, "software | ");
	}
	if (reason & NRFX_RESET_REASON_LOCKUP_MASK) {
		(void)strcat(str, "CPU lockup | ");
	}
	if (reason & NRFX_RESET_REASON_CTRLAP_MASK) {
		(void)strcat(str, "control access port | ");
	}

	len = strlen(str);
	if (len == 0) {
		(void)strcpy(str, "power-on reset");
	} else {
		str[len - 3] = '\0';
	}
}

static void mosh_print_reset_reason(void)
{
	uint32_t reset_reason;
	char reset_reason_str[128];

	/* Read RESETREAS register value and clear current reset reason(s). */
	reset_reason = nrfx_reset_reason_get();
	nrfx_reset_reason_clear(reset_reason);

	reset_reason_str_get(reset_reason_str, reset_reason);

	printk("\nReset reason: %s\n", reset_reason_str);
}

#if defined(CONFIG_DK_LIBRARY)
static void button_handler(uint32_t button_states, uint32_t has_changed)
{
	if (has_changed & button_states & DK_BTN1_MSK) {
		mosh_print("Button 1 pressed - raising a kill signal");
		k_poll_signal_raise(&mosh_signal, MOSH_SIGNAL_KILL);
#if defined(CONFIG_MOSH_WORKER_THREADS)
		th_ctrl_kill_em_all();
#endif
	} else if (has_changed & ~button_states & DK_BTN1_MSK) {
		mosh_print("Button 1 released - resetting a kill signal");
		k_poll_signal_reset(&mosh_signal);
	}

	if (has_changed & button_states & DK_BTN2_MSK) {
		mosh_print("Button 2 pressed, toggling UART power state");
		uart_toggle_power_state();
	}
}
#endif

int main(void)
{
	int err;
	struct k_work_queue_config cfg = {
		.name = "mosh_common_workq",
	};

#if defined(CONFIG_SHELL_BACKEND_SERIAL)
	mosh_shell = shell_backend_uart_get_ptr();
#else
	mosh_shell = shell_backend_rtt_get_ptr();
#endif

	__ASSERT(mosh_shell != NULL, "Failed to get shell backend");

	/* Reset reason can only be read once, because the register needs to be cleared after
	 * reading. Memfault implementation reads the reset reason before modem_shell, so the
	 * register would always be empty.
	 */
	if (!IS_ENABLED(CONFIG_MEMFAULT)) {
		mosh_print_reset_reason();
	}

#if defined(CONFIG_NRF_CLOUD_MQTT) || defined(CONFIG_NRF_CLOUD_COAP)
#if defined(CONFIG_MOSH_IPERF3)
	/* Due to iperf3, we cannot let nrf cloud lib to initialize cJSON lib to be
	 * using kernel heap allocations (i.e. k_ prepending functions).
	 * Thus, we use standard c alloc/free, i.e. "system heap".
	 */
	struct nrf_cloud_os_mem_hooks hooks = {
		.malloc_fn = malloc,
		.calloc_fn = calloc,
		.free_fn = free,
	};
#else
	/* else: we default to Kernel heap */
	struct nrf_cloud_os_mem_hooks hooks = {
		.malloc_fn = k_malloc,
		.calloc_fn = k_calloc,
		.free_fn = k_free,
	};
#endif

	nrf_cloud_os_mem_hooks_init(&hooks);
#endif

	k_work_queue_start(
		&mosh_common_work_q,
		mosh_common_workq_stack,
		K_THREAD_STACK_SIZEOF(mosh_common_workq_stack),
		MOSH_COMMON_WORKQ_PRIORITY,
		&cfg);

	err = nrf_modem_lib_init();
	if (err) {
		/* Modem library initialization failed. */
		printk("Could not initialize nrf_modem_lib, err %d\n", err);
		printk("Fatal error\n");
		return 0;
	}

#if defined(CONFIG_MOSH_PPP)
	ppp_ctrl_init();
#endif
#if defined(CONFIG_MOSH_WORKER_THREADS)
	th_ctrl_init();
#endif
#if defined(CONFIG_MOSH_FOTA)
	err = fota_init();
	if (err) {
		printk("Could not initialize FOTA: %d\n", err);
	}
#endif

#if defined(CONFIG_MOSH_LOCATION)
	/* Location library should be initialized before LTE normal mode */
	location_ctrl_init();
#endif
	link_init();

	err = modem_info_init();
	if (err) {
		printk("Modem info could not be initialized: %d\n", err);
		return 0;
	}

	/* Version information printing uses the Modem information library, so it can not be done
	 * before the library has been initialized.
	 */
	mosh_print_version_info();

#if defined(CONFIG_DK_LIBRARY)
	err = dk_buttons_init(button_handler);
	if (err) {
		printk("Failed to initialize DK buttons library, error: %d\n", err);
	}
#endif
	/* Application started successfully, mark image as OK to prevent
	 * revert at next reboot. If LwM2M Carrier library is enabled, allow
	 * the library to do it.
	 */
#if (defined(CONFIG_BOOTLOADER_MCUBOOT) && !defined(CONFIG_LWM2M_CARRIER))
	boot_write_img_confirmed();
#endif
	k_poll_signal_init(&mosh_signal);

#if defined(CONFIG_SHELL_BACKEND_SERIAL)
	/* Resize terminal width and height of the shell to have proper command editing. */
	shell_execute_cmd(mosh_shell, "resize");
#endif

#if defined(CONFIG_MOSH_STARTUP_CMDS)
	startup_cmd_ctrl_init();
#endif

#if defined(CONFIG_MOSH_AT_CMD_MODE)
	at_cmd_mode_sett_init();
	if (at_cmd_mode_sett_is_autostart_enabled()) {
		/* Start directly in AT cmd mode */
		at_cmd_mode_start(mosh_shell);
	}
#endif

	return 0;
}
```
