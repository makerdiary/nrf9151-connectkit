## boards/makerdiary/nrf9151_connectkit/Kconfig.defconfig
```kconfig
# nRF9151 Connect Kit board configuration

# Copyright (c) 2016-2026 Makerdiary <https://makerdiary.com>
# SPDX-License-Identifier: Apache-2.0

config HW_STACK_PROTECTION
	default ARCH_HAS_STACK_PROTECTION

if BOARD_NRF9151_CONNECTKIT_NRF9151 || BOARD_NRF9151_CONNECTKIT_NRF9151_NS

config BOARD_NRF9151_CONNECTKIT
	select USE_DT_CODE_PARTITION if BOARD_NRF9151_CONNECTKIT_NRF9151_NS

endif # BOARD_NRF9151_CONNECTKIT_NRF9151 || BOARD_NRF9151_CONNECTKIT_NRF9151_NS
```

## boards/makerdiary/nrf9151_connectkit/board.yml
```yaml
board:
  name: nrf9151_connectkit
  full_name: nRF9151 Connect Kit
  vendor: makerdiary
  socs:
  - name: nrf52820
  - name: nrf9151
    variants:
    - name: 'ns'
```

## drivers/Kconfig
```kconfig
# Copyright (c) 2016-2026 Makerdiary <https://makerdiary.com>
# SPDX-License-Identifier: Apache-2.0

menu "Drivers"
rsource "charger/Kconfig"
endmenu
```

## drivers/charger/Kconfig
```kconfig
# Copyright 2024 Google LLC
# Copyright 2016-2026 Makerdiary <https://makerdiary.com>
#
# SPDX-License-Identifier: Apache-2.0

config BQ2518X
	bool "BQ2518x Battery Charger"
	default y
	depends on DT_HAS_TI_BQ2518X_ENABLED
    depends on !(DT_HAS_TI_BQ25180_ENABLED || DT_HAS_TI_BQ25186_ENABLED || \
		DT_HAS_TI_BQ25188_ENABLED)
	select I2C
	help
	  Enable BQ2518x battery charger driver.
```

## samples/nrf_cloud_coap_cell_location/sample.yaml
```yaml
sample:
  name: nRF Cloud CoAP cellular location
tests:
  sample.nrf_cloud_coap_cell_location:
    sysbuild: true
    build_only: true
    integration_platforms:
      - nrf9151_connectkit/nrf9151/ns
```

## samples/nrf_cloud_mqtt_cell_location/sample.yaml
```yaml
sample:
  name: nRF Cloud MQTT cellular location
tests:
  sample.nrf_cloud_mqtt_cell_location:
    sysbuild: true
    build_only: true
    integration_platforms:
      - nrf9151_connectkit/nrf9151/ns
```

## west.yml
```yaml
# Copyright (c) 2016-2026 Makerdiary <https://makerdiary.com>
# SPDX-License-Identifier: Apache-2.0

manifest:
  self: 
    path: nrf9151-connectkit

  remotes:
    - name: makerdiary
      url-base: https://github.com/makerdiary
    - name: zephyrproject-rtos
      url-base: https://github.com/zephyrproject-rtos
    - name: nrfconnect
      url-base: https://github.com/nrfconnect

  projects:
    - name: nrf
      remote: nrfconnect
      repo-path: sdk-nrf
      revision: 87282dad802b0129d22c60acd2535cefc1941aa6
      import: true
```
